## CMakeLists.txt
```
#
# Copyright (c) 2025 Microchip Technology Inc.
#
# SPDX-License-Identifier: Apache-2.0

cmake_minimum_required(VERSION 3.20.0)
find_package(Zephyr REQUIRED HINTS $ENV{ZEPHYR_BASE})
project(peripheral_trp_uart)

target_sources(app PRIVATE
  src/main.c
  src/app.c
  src/app_ble.c
  src/app_ble_handler.c
  src/app_ble_policy.c
  src/app_ble_discovery.c
  src/app_trsps_handler.c
)
```

## Kconfig
```
# Copyright (c) 2025 Microchip Technology Inc.
# SPDX-License-Identifier: Apache-2.0

mainmenu "Bluetooth: Peripheral TRP UART"

# TRS_SERVER_* options are now defined in
# subsys/bluetooth/services/trs/Kconfig.trs
# and do not need to be redeclared here.

source "Kconfig.zephyr"
```

## sample.yaml
```
sample:
  name: Peripheral Transparent Uart
  description: This application enables users to send data back and forth over UART between two connected BLE devices.
  tags: bluetooth
tests:
  build:
    platform_allow::
      - wbz451_curiosity/pic32cx1012bz25048
      - wbz351_curiosity/pic32cx5109bz31048
      - pic32wm_bz6204_curiosity/pic32cx2051bz62132
    tags: bluetooth
```

## prj.conf
```kconfig
#
# Copyright (c) 2025 Microchip Technology Inc.
#
# SPDX-License-Identifier: Apache-2.0
#

# Bluetooth core
CONFIG_BT=y
CONFIG_BT_PERIPHERAL=y
CONFIG_BT_SMP=y
CONFIG_BT_SETTINGS=y
CONFIG_BT_GATT_DYNAMIC_DB=y
CONFIG_BT_DEVICE_NAME="Microchip"
CONFIG_BT_MAX_CONN=1

# BT buffer sizing
CONFIG_BT_L2CAP_TX_MTU=247
CONFIG_BT_BUF_ACL_RX_SIZE=255
CONFIG_BT_BUF_ACL_TX_SIZE=251
CONFIG_BT_BUF_CMD_TX_SIZE=255
CONFIG_BT_RX_STACK_SIZE=2048

# Persistent settings (bond storage)
CONFIG_FLASH=y
CONFIG_FLASH_MAP=y
CONFIG_NVS=y
CONFIG_SETTINGS=y

# Net buf (required by TRS server)
CONFIG_NET_BUF=y

# System work queue
CONFIG_SYSTEM_WORKQUEUE_STACK_SIZE=2048

# Logging
CONFIG_LOG=y

# TRS service + server profile layers
CONFIG_BT_TRS=y
CONFIG_BT_TRS_SERVER=y

# TRS server tuning (override subsys defaults if needed)
CONFIG_TRS_SERVER_CREDIT=16
CONFIG_TRS_SERVER_BUF_POOL_SIZE=16
CONFIG_TRS_SERVER_BUF_DATA_SIZE=244
```

## src/main.c
```c
/*
 * Copyright (c) 2026 Microchip Technology Inc.
 *
 * SPDX-License-Identifier: Apache-2.0
 */

#include <zephyr/logging/log.h>

#include "app.h"

LOG_MODULE_REGISTER(main);

int main(void)
{
    int err;

    err = app_init();
    if (err != 0) {
        LOG_ERR("Application init failed (err %d)", err);
    }

    return 0;
}
```

## src/app.c
```c
/*
 * Copyright (c) 2026 Microchip Technology Inc.
 *
 * SPDX-License-Identifier: Apache-2.0
 */

#include <zephyr/types.h>
#include <stddef.h>
#include <string.h>
#include <errno.h>

#include <zephyr/kernel.h>
#include <zephyr/logging/log.h>
#include <zephyr/sys/util.h>
#include <zephyr/drivers/uart.h>

#include "app.h"
#include <zephyr/bluetooth/services/trs/trs_server.h>
#include "app_ble.h"
#include "app_ble_handler.h"
#include "app_trsps_handler.h"

LOG_MODULE_REGISTER(app);

#define UART_TX_BUF_SIZE       244
#define RING_BUF_SIZE          512
#define UART_TX_RETRY_DELAY_MS 10U

#define UART_DEVICE_NODE DT_CHOSEN(zephyr_shell_uart)

/* ISR is the sole producer (ring_buf_put_claim/finish); work queue is the
 * sole consumer (ring_buf_get).  Safe on single-core without an explicit lock. */
RING_BUF_DECLARE(uart_to_ble_ring, RING_BUF_SIZE);

static const struct device *const uart_dev = DEVICE_DT_GET(UART_DEVICE_NODE);

/* [work-queue context] UART→BLE notify pump. */
static struct k_work uart_to_ble_work;
static struct k_work_delayable uart_to_ble_retry_work;
/* Pending retry chunk — work-queue context only, no lock needed. */
static uint8_t uart_to_ble_pending[UART_TX_BUF_SIZE];
static size_t uart_to_ble_pending_len;

/* [work-queue context]: BLE notify APIs are not ISR-safe. */
static void uart_to_ble_work_handler(struct k_work *work)
{
	struct bt_conn *conn;
	int err;
	int conn_err;
	uint16_t tx_mtu = 0U;
	size_t bytes_read = 0;
	size_t payload_mtu;
	uint8_t tx_buff[UART_TX_BUF_SIZE] = {0U};

	ARG_UNUSED(work);

	/* Acquires a reference; conn must be released at 'out' on every exit path. */
	conn_err = app_ble_handler_conn_ref_get(&conn);
	if (conn_err != 0) {
		return;
	}

	trs_server_get_tx_mtu(conn, &tx_mtu);

	/* ATT notification header is 3 bytes; guard against zero or negative
	 * payload.  MTU may still be at the default 23 if exchange has not
	 * completed yet — retry after a short delay. */
	if (tx_mtu <= 4U) {
		(void)k_work_reschedule(&uart_to_ble_retry_work, K_MSEC(UART_TX_RETRY_DELAY_MS));
		goto out;
	}

	payload_mtu = MIN((size_t)(tx_mtu - 4U), sizeof(tx_buff));

	/* Send any previously failed chunk first to preserve UART→BLE byte ordering
	 * before consuming new data from the ring buffer. */
	if (uart_to_ble_pending_len > 0U) {
		err = trs_server_send_data(conn, (uint16_t)uart_to_ble_pending_len,
					   uart_to_ble_pending);
		if (err < 0) {
			/* -ENOBUFS/-ENOTSUP/-EAGAIN are transient BLE stack conditions; retry. */
			if ((err == -ENOBUFS) || (err == -ENOTSUP) || (err == -EAGAIN)) {
				(void)k_work_reschedule(&uart_to_ble_retry_work,
							K_MSEC(UART_TX_RETRY_DELAY_MS));
			}
			goto out;
		}

		uart_to_ble_pending_len = 0U;
	}

	while ((bytes_read = ring_buf_get(&uart_to_ble_ring, &tx_buff[0], payload_mtu)) > 0U) {
		err = trs_server_send_data(conn, (uint16_t)bytes_read, &tx_buff[0]);
		if (err < 0) {
			/* Save the failed chunk so the retry handler can resend it
			 * without losing UART data. */
			if (bytes_read <= sizeof(uart_to_ble_pending)) {
				(void)memcpy(uart_to_ble_pending, tx_buff, bytes_read);
				uart_to_ble_pending_len = bytes_read;
			}

			if ((err == -ENOBUFS) || (err == -ENOTSUP) || (err == -EAGAIN)) {
				(void)k_work_reschedule(&uart_to_ble_retry_work,
							K_MSEC(UART_TX_RETRY_DELAY_MS));
			} else {
				LOG_ERR("UART->BLE notify failed (err %d)", err);
			}
			break;
		}
	}

out:
	bt_conn_unref(conn);
}

static void uart_to_ble_retry_handler(struct k_work *work)
{
	ARG_UNUSED(work);
	k_work_submit(&uart_to_ble_work);
}

/* TX channel open or CBFC credits granted: start UART→BLE pump. */
static void on_ble_tx_channel_ready(void *context)
{
	ARG_UNUSED(context);
	k_work_submit(&uart_to_ble_work);
}

static void app_ble_state_changed(bool connected, uint8_t reason, void *context)
{
	ARG_UNUSED(reason);
	ARG_UNUSED(context);

	if (connected) {
		/* Drain any UART data buffered before the connection was established. */
		k_work_submit(&uart_to_ble_work);
		return;
	}

	/* Discard pending UART→BLE retry data and stop the timer; the connection
	 * the data was queued for no longer exists. */
	uart_to_ble_pending_len = 0U;
	(void)k_work_cancel_delayable(&uart_to_ble_retry_work);

	/* Schedule deferred advertising restart so it runs after the BT stack
	 * has fully released the connection resources (avoids -ENOMEM). */
	app_ble_adv_restart();
}

static void uart_read_to_ringbuf(void)
{
	uint8_t buf[32U] = {0};
	uint8_t *ptr;
	size_t claimed = 0;
	int bytes_read;
	int bytes_to_store;

	bytes_read = uart_fifo_read(uart_dev, buf, sizeof(buf));
	if (bytes_read > 0) {
		/* ring_buf_put_claim returns a single contiguous window and may
		 * return less than requested at the wrap-around boundary.
		 * Excess bytes are dropped; the overflow log indicates data loss. */
		claimed = ring_buf_put_claim(&uart_to_ble_ring, &ptr, (uint32_t)bytes_read);
		if (claimed > 0U) {
			bytes_to_store = (int)MIN(claimed, (size_t)bytes_read);
			(void)memcpy(ptr, buf, (size_t)bytes_to_store);
			ring_buf_put_finish(&uart_to_ble_ring, (uint32_t)bytes_to_store);
			if (bytes_read > bytes_to_store) {
				LOG_ERR("uart_to_ble_ring overflow: UART data dropped");
			}
		} else {
			LOG_ERR("uart_to_ble_ring full: UART data dropped");
		}
	}
}

/* [ISR context] UART RX/TX interrupt dispatcher. */
static void uart_isr(const struct device *unused, void *user_data)
{
	ARG_UNUSED(unused);
	ARG_UNUSED(user_data);

	/* Loop until all pending flags are cleared.  A single IRQ entry can
	 * represent simultaneous RX-ready and TX-empty events on most controllers;
	 * processing both in one pass reduces re-entry overhead. */
	while (uart_irq_update(uart_dev) && uart_irq_is_pending(uart_dev)) {
		if (!(uart_irq_rx_ready(uart_dev) || uart_irq_tx_ready(uart_dev))) {
			LOG_INF("spurious interrupt");
		}

		/* BLE→UART direction: feed queued BLE data into the UART TX FIFO. */
		if (uart_irq_tx_ready(uart_dev)) {
			app_trsps_handler_ble_to_uart_service();
		}

		/* UART→BLE direction: drain UART RX FIFO into ring buffer. */
		if (uart_irq_rx_ready(uart_dev)) {
			uart_read_to_ringbuf();
			/* k_work_submit and app_ble_handler_is_connected() are both ISR-safe. */
			if (app_ble_handler_is_connected()) {
				k_work_submit(&uart_to_ble_work);
			}
		}
	}
}

static int uart_init(void)
{
	if (!device_is_ready(uart_dev)) {
		return -ENODEV;
	}

	/* Disable both interrupts before registering the callback to prevent a
	 * stray IRQ firing with a NULL handler if a bootloader left them enabled. */
	uart_irq_rx_disable(uart_dev);
	uart_irq_tx_disable(uart_dev);

	uart_irq_callback_set(uart_dev, uart_isr);
	uart_irq_rx_enable(uart_dev);
	/* TX interrupt enabled on-demand by ble_to_uart_enqueue() only when
	 * BLE→UART data is ready, preventing a continuous empty-FIFO IRQ loop. */

	return 0;
}

int app_init(void)
{
	int err;

	/* Work items must be initialized before uart_init() arms the RX interrupt.
	 * A byte arriving immediately after uart_irq_rx_enable() would call
	 * k_work_submit() on an uninitialized struct, causing undefined behavior. */
	k_work_init(&uart_to_ble_work, uart_to_ble_work_handler);
	k_work_init_delayable(&uart_to_ble_retry_work, uart_to_ble_retry_handler);

	err = uart_init();
	if (err != 0) {
		return err;
	}

	/* BLE connection callbacks must be registered before bt_enable() so no
	 * connect or disconnect event is missed during the startup window. */
	err = app_ble_handler_init(app_ble_state_changed, NULL);
	if (err != 0) {
		LOG_ERR("BLE handler init failed (err %d)", err);
		return err;
	}

	/* TRS server callback must be registered before bt_enable() so the first
	 * GATT write after connection is not silently dropped. */
	err = app_trsps_handler_init(uart_dev, on_ble_tx_channel_ready, NULL);
	if (err != 0) {
		LOG_ERR("TRSPS handler init failed (err %d)", err);
		return err;
	}

	/* bt_enable() is asynchronous; advertising starts from app_ble_ready_cb()
	 * in the BT RX thread after this function has already returned. */
	err = app_ble_init();
	if (err != 0) {
		LOG_ERR("BLE init failed (err %d)", err);
		return err;
	}

	return 0;
}
```

## src/app.h
```c
/*
 * Copyright (c) 2026 Microchip Technology Inc.
 *
 * SPDX-License-Identifier: Apache-2.0
 */

#ifndef APP_H_
#define APP_H_

int app_init(void);

#endif /* APP_H_ */
```

## src/app_ble.c
```c
/*
 * Copyright (c) 2026 Microchip Technology Inc.
 *
 * SPDX-License-Identifier: Apache-2.0
 */

#include <errno.h>

#include <zephyr/kernel.h>
#include <zephyr/bluetooth/bluetooth.h>
#include <zephyr/bluetooth/hci.h>
#include <zephyr/settings/settings.h>

#include "app_ble.h"

#include <zephyr/logging/log.h>
LOG_MODULE_REGISTER(app_ble);

#define APP_BLE_DEVICE_NAME     CONFIG_BT_DEVICE_NAME
#define APP_BLE_DEVICE_NAME_LEN (sizeof(APP_BLE_DEVICE_NAME) - 1)

/* 50 ms gives the BT stack time to fully release connection resources
 * before bt_le_adv_start() is called again; avoids -ENOMEM from the runner. */
#define APP_BLE_ADV_RESTART_DELAY_MS  50U

static const struct bt_data app_ble_ad[] = {
	BT_DATA_BYTES(BT_DATA_FLAGS, (BT_LE_AD_GENERAL | BT_LE_AD_NO_BREDR)),
	BT_DATA_BYTES(BT_DATA_SVC_DATA16, 0xDA, 0xFE, 0xFF, 0x01),
	BT_DATA(BT_DATA_NAME_COMPLETE, APP_BLE_DEVICE_NAME, APP_BLE_DEVICE_NAME_LEN),
};

/* Guards against calling bt_enable() more than once; the BT stack does not
 * support re-initialization. */
static bool app_ble_init_requested;
static bool app_ble_ready;

static struct k_work_delayable app_ble_adv_restart_dwork;

static int app_ble_adv_start(void)
{
	int err;

	err = bt_le_adv_start(BT_LE_ADV_CONN_FAST_1, app_ble_ad, ARRAY_SIZE(app_ble_ad), NULL, 0);
	if (err == -EALREADY) {
		return 0;
	}
	if (err != 0) {
		LOG_ERR("Advertising failed to start (err %d)", err);
		return err;
	}

	LOG_INF("Configuration mode: waiting connections...");
	return 0;
}

/* [work-queue context] bt_le_adv_start() succeeds here after the stack releases the connection slot. */
static void app_ble_adv_restart_work_handler(struct k_work *work)
{
	ARG_UNUSED(work);
	(void)app_ble_adv_start();
}

void app_ble_adv_restart(void)
{
	(void)k_work_reschedule(&app_ble_adv_restart_dwork,
				K_MSEC(APP_BLE_ADV_RESTART_DELAY_MS));
}

/* [BT RX thread] bt_le_adv_start() is thread-safe here. */
static void app_ble_ready_cb(int err)
{
	int rc;

	if (err != 0) {
		LOG_ERR("Bluetooth init failed (err %d)", err);
		return;
	}

	app_ble_ready = true;
	LOG_INF("Bluetooth initialized");

	if (IS_ENABLED(CONFIG_SETTINGS)) {
		rc = settings_load();
		if (rc != 0) {
			LOG_WRN("settings_load failed (err %d)", rc);
		}
	}

	(void)app_ble_adv_start();
}

int app_ble_init(void)
{
	int err;

	if (app_ble_init_requested) {
		return 0;
	}

	k_work_init_delayable(&app_ble_adv_restart_dwork, app_ble_adv_restart_work_handler);

	app_ble_init_requested = true;

	err = bt_enable(app_ble_ready_cb);
	if (err != 0) {
		app_ble_init_requested = false;
		LOG_ERR("Bluetooth enable failed (err %d)", err);
		return err;
	}

	return 0;
}

bool app_ble_is_ready(void)
{
	return app_ble_ready;
}
```

## src/app_ble.h
```c
/*
 * Copyright (c) 2026 Microchip Technology Inc.
 *
 * SPDX-License-Identifier: Apache-2.0
 */

#ifndef APP_BLE_H_
#define APP_BLE_H_

#include <stdbool.h>

int app_ble_init(void);

bool app_ble_is_ready(void);

/* Schedules a deferred advertising restart from the system work queue.
 * Must be used instead of calling bt_le_adv_start() directly from a BT
 * disconnect callback to avoid -ENOMEM while the stack is still releasing
 * connection resources. */
void app_ble_adv_restart(void);

#endif /* APP_BLE_H_ */
```

## src/app_ble_discovery.c
```c
/*
 * Copyright (c) 2026 Microchip Technology Inc.
 *
 * SPDX-License-Identifier: Apache-2.0
 */

#include <errno.h>
#include <string.h>

#include <zephyr/kernel.h>
#include <zephyr/bluetooth/gatt.h>

#include <zephyr/bluetooth/services/trs/trs.h>
#include "app_ble_discovery.h"

#include <zephyr/logging/log.h>
LOG_MODULE_REGISTER(app_ble_discovery);

static struct bt_uuid_128 app_ble_discovery_uuid_trs = BT_UUID_INIT_128(BT_UUID_TRS_VAL);
static struct bt_uuid_128 app_ble_discovery_uuid_tx = BT_UUID_INIT_128(BT_UUID_TX_CHAR_VAL);
static struct bt_uuid_128 app_ble_discovery_uuid_rx = BT_UUID_INIT_128(BT_UUID_RX_CHAR_VAL);
static struct bt_uuid_128 app_ble_discovery_uuid_cp = BT_UUID_INIT_128(BT_UUID_CP_CHAR_VAL);

static struct k_spinlock app_ble_discovery_lock;
static struct bt_conn *app_ble_discovery_conn;
/* Must remain valid for the full discovery sequence; bt_gatt_discover() holds
 * a pointer to this struct until the callback signals completion. */
static struct bt_gatt_discover_params app_ble_discover_params;
static struct app_ble_discovery_result app_ble_discovery_result;
static app_ble_discovery_cb_t app_ble_discovery_cb;
static void *app_ble_discovery_cb_ctx;
static bool app_ble_discovery_initialized;
static bool app_ble_discovery_in_progress;
static bool app_ble_discovery_completed;
static int app_ble_discovery_status;

static void app_ble_discovery_reset_result(void)
{
	(void)memset(&app_ble_discovery_result, 0, sizeof(app_ble_discovery_result));
}

static bool app_ble_discovery_has_trs_handles(void)
{
	return (app_ble_discovery_result.tx_value_handle != 0U) &&
	       (app_ble_discovery_result.rx_value_handle != 0U) &&
	       (app_ble_discovery_result.cp_value_handle != 0U);
}

static void app_ble_discovery_notify(struct bt_conn *conn, int status)
{
	app_ble_discovery_cb_t cb;
	void *cb_ctx;
	struct app_ble_discovery_result result_snapshot;

	{
		k_spinlock_key_t key = k_spin_lock(&app_ble_discovery_lock);

		cb = app_ble_discovery_cb;
		cb_ctx = app_ble_discovery_cb_ctx;
		result_snapshot = app_ble_discovery_result;

		k_spin_unlock(&app_ble_discovery_lock, key);
	}

	if (cb != NULL) {
		cb(conn, &result_snapshot, status, cb_ctx);
	}
}

static void app_ble_discovery_complete(struct bt_conn *conn, int status)
{
	{
		k_spinlock_key_t key = k_spin_lock(&app_ble_discovery_lock);

		app_ble_discovery_in_progress = false;
		app_ble_discovery_completed = true;
		app_ble_discovery_status = status;
		(void)memset(&app_ble_discover_params, 0, sizeof(app_ble_discover_params));

		k_spin_unlock(&app_ble_discovery_lock, key);
	}

	app_ble_discovery_notify(conn, status);
}

/* GATT discovery callback: NULL attr signals end of this discovery phase. */
static uint8_t app_ble_discover_func(struct bt_conn *conn,
				     const struct bt_gatt_attr *attr,
				     struct bt_gatt_discover_params *params)
{
	uint8_t discover_type;

	if (params == NULL) {
		return BT_GATT_ITER_STOP;
	}

	discover_type = params->type;

	if (attr == NULL) {
		if (discover_type == BT_GATT_DISCOVER_PRIMARY) {
			LOG_INF("TRS discovery complete: service not found");
			app_ble_discovery_complete(conn, -ENOENT);
		} else if (discover_type == BT_GATT_DISCOVER_CHARACTERISTIC) {
			int status = app_ble_discovery_has_trs_handles() ? 0 : -ENOENT;

			if (status == 0) {
				LOG_INF("TRS discovery complete: TX=0x%04x RX=0x%04x CP=0x%04x",
					app_ble_discovery_result.tx_value_handle,
					app_ble_discovery_result.rx_value_handle,
					app_ble_discovery_result.cp_value_handle);
			} else {
				LOG_WRN("TRS discovery incomplete: missing one or more characteristic handles");
			}
			app_ble_discovery_complete(conn, status);
		}

		return BT_GATT_ITER_STOP;
	}

	if (discover_type == BT_GATT_DISCOVER_PRIMARY) {
		const struct bt_gatt_service_val *svc = attr->user_data;
		int err;

		{
			k_spinlock_key_t key = k_spin_lock(&app_ble_discovery_lock);

			app_ble_discovery_result.svc_start_handle = attr->handle;
			app_ble_discovery_result.svc_end_handle = (svc != NULL)
								      ? svc->end_handle
								      : BT_ATT_LAST_ATTRIBUTE_HANDLE;

			k_spin_unlock(&app_ble_discovery_lock, key);
		}

		params->uuid = NULL;
		params->start_handle = attr->handle + 1U;
		params->end_handle = (svc != NULL) ? svc->end_handle : BT_ATT_LAST_ATTRIBUTE_HANDLE;
		params->type = BT_GATT_DISCOVER_CHARACTERISTIC;

		err = bt_gatt_discover(conn, params);
		if (err != 0) {
			LOG_ERR("TRS characteristic discovery failed to start (%d)", err);
			app_ble_discovery_complete(conn, err);
		}

		return BT_GATT_ITER_STOP;
	}

	if (discover_type == BT_GATT_DISCOVER_CHARACTERISTIC) {
		const struct bt_gatt_chrc *chrc = attr->user_data;

		if (chrc == NULL) {
			return BT_GATT_ITER_CONTINUE;
		}

		{
			k_spinlock_key_t key = k_spin_lock(&app_ble_discovery_lock);

			if (!bt_uuid_cmp(chrc->uuid, &app_ble_discovery_uuid_tx.uuid)) {
				app_ble_discovery_result.tx_value_handle = chrc->value_handle;
			} else if (!bt_uuid_cmp(chrc->uuid, &app_ble_discovery_uuid_rx.uuid)) {
				app_ble_discovery_result.rx_value_handle = chrc->value_handle;
			} else if (!bt_uuid_cmp(chrc->uuid, &app_ble_discovery_uuid_cp.uuid)) {
				app_ble_discovery_result.cp_value_handle = chrc->value_handle;
			}

			k_spin_unlock(&app_ble_discovery_lock, key);
		}

		return BT_GATT_ITER_CONTINUE;
	}

	return BT_GATT_ITER_STOP;
}

/* Registers the optional result callback; idempotent on repeated calls. */
int app_ble_discovery_init(app_ble_discovery_cb_t cb, void *cb_ctx)
{
	{
		k_spinlock_key_t key = k_spin_lock(&app_ble_discovery_lock);

		app_ble_discovery_cb = cb;
		app_ble_discovery_cb_ctx = cb_ctx;

		if (app_ble_discovery_initialized) {
			k_spin_unlock(&app_ble_discovery_lock, key);
			return 0;
		}

		app_ble_discovery_status = -EAGAIN;
		app_ble_discovery_initialized = true;

		k_spin_unlock(&app_ble_discovery_lock, key);
	}

	return 0;
}

/* Starts TRS primary service and characteristic discovery on conn.
 * Returns -EINVAL (NULL conn), -EALREADY (in progress), -EACCES (not initialized). */
int app_ble_discovery_start(struct bt_conn *conn)
{
	struct bt_conn *old_conn = NULL;
	int err;

	if (conn == NULL) {
		return -EINVAL;
	}

	{
		k_spinlock_key_t key = k_spin_lock(&app_ble_discovery_lock);

		if (!app_ble_discovery_initialized) {
			k_spin_unlock(&app_ble_discovery_lock, key);
			return -EACCES;
		}

		if (app_ble_discovery_in_progress) {
			k_spin_unlock(&app_ble_discovery_lock, key);
			return -EALREADY;
		}

		old_conn = app_ble_discovery_conn;
		app_ble_discovery_conn = bt_conn_ref(conn);
		app_ble_discovery_in_progress = true;
		app_ble_discovery_completed = false;
		app_ble_discovery_status = -EINPROGRESS;
		app_ble_discovery_reset_result();

		(void)memset(&app_ble_discover_params, 0, sizeof(app_ble_discover_params));
		app_ble_discover_params.uuid = &app_ble_discovery_uuid_trs.uuid;
		app_ble_discover_params.func = app_ble_discover_func;
		app_ble_discover_params.start_handle = BT_ATT_FIRST_ATTRIBUTE_HANDLE;
		app_ble_discover_params.end_handle = BT_ATT_LAST_ATTRIBUTE_HANDLE;
		app_ble_discover_params.type = BT_GATT_DISCOVER_PRIMARY;

		k_spin_unlock(&app_ble_discovery_lock, key);
	}

	/* Unref the stale connection outside the spinlock to avoid calling
	 * bt_conn_unref() while holding the lock. */
	if (old_conn != NULL) {
		bt_conn_unref(old_conn);
	}

	err = bt_gatt_discover(conn, &app_ble_discover_params);
	if (err != 0) {
		LOG_ERR("TRS service discovery failed to start (%d)", err);
		app_ble_discovery_complete(conn, err);
		return err;
	}

	return 0;
}

/* Copies discovered handles to result.
 * Returns -EINPROGRESS (still running), -ENOTCONN (no conn), -ENOENT (conn mismatch). */
int app_ble_discovery_result_get(struct bt_conn *conn,
				 struct app_ble_discovery_result *result)
{
	int status;

	if (result == NULL) {
		return -EINVAL;
	}

	{
		k_spinlock_key_t key = k_spin_lock(&app_ble_discovery_lock);

		if (app_ble_discovery_conn == NULL) {
			k_spin_unlock(&app_ble_discovery_lock, key);
			return -ENOTCONN;
		}

		if ((conn != NULL) && (conn != app_ble_discovery_conn)) {
			k_spin_unlock(&app_ble_discovery_lock, key);
			return -ENOENT;
		}

		if (!app_ble_discovery_completed) {
			k_spin_unlock(&app_ble_discovery_lock, key);
			return -EINPROGRESS;
		}

		*result = app_ble_discovery_result;
		status = app_ble_discovery_status;

		k_spin_unlock(&app_ble_discovery_lock, key);
	}

	return status;
}

/* Cleans up discovery state for conn; no-op if conn is not tracked. */
void app_ble_discovery_on_disconnected(struct bt_conn *conn, uint8_t reason)
{
	struct bt_conn *to_unref = NULL;

	ARG_UNUSED(reason);

	if (conn == NULL) {
		return;
	}

	{
		k_spinlock_key_t key = k_spin_lock(&app_ble_discovery_lock);

		if (app_ble_discovery_conn == conn) {
			to_unref = app_ble_discovery_conn;
			app_ble_discovery_conn = NULL;
			app_ble_discovery_in_progress = false;
			app_ble_discovery_completed = false;
			app_ble_discovery_status = -ENOTCONN;
			app_ble_discovery_reset_result();
			(void)memset(&app_ble_discover_params, 0, sizeof(app_ble_discover_params));
		}

		k_spin_unlock(&app_ble_discovery_lock, key);
	}

	if (to_unref != NULL) {
		bt_conn_unref(to_unref);
	}
}
```

## src/app_ble_discovery.h
```c
/*
 * Copyright (c) 2026 Microchip Technology Inc.
 *
 * SPDX-License-Identifier: Apache-2.0
 */

#ifndef APP_BLE_DISCOVERY_H_
#define APP_BLE_DISCOVERY_H_

#include <stdint.h>

#include <zephyr/bluetooth/conn.h>

struct app_ble_discovery_result {
    uint16_t svc_start_handle;
    uint16_t svc_end_handle;
    uint16_t tx_value_handle;
    uint16_t rx_value_handle;
    uint16_t cp_value_handle;
};

typedef void (*app_ble_discovery_cb_t)(struct bt_conn *conn,
                                        const struct app_ble_discovery_result *result,
                                        int status,
                                        void *context);

int app_ble_discovery_init(app_ble_discovery_cb_t cb, void *cb_ctx);

int app_ble_discovery_start(struct bt_conn *conn);

int app_ble_discovery_result_get(struct bt_conn *conn,
                                 struct app_ble_discovery_result *result);

void app_ble_discovery_on_disconnected(struct bt_conn *conn, uint8_t reason);

#endif /* APP_BLE_DISCOVERY_H_ */
```

## src/app_ble_handler.c
```c
/*
 * Copyright (c) 2026 Microchip Technology Inc.
 *
 * SPDX-License-Identifier: Apache-2.0
 */

#include <errno.h>

#include <zephyr/kernel.h>

#include <zephyr/bluetooth/conn.h>
#include <zephyr/bluetooth/hci.h>

#include "app_ble_handler.h"
#include "app_ble_discovery.h"
#include "app_ble_policy.h"

#include <zephyr/logging/log.h>
LOG_MODULE_REGISTER(app_ble_handler);

static struct bt_conn *app_ble_conn;
/* Spinlock rather than mutex: app_ble_handler_is_connected() is called from
 * uart_isr() in ISR context where a mutex cannot be acquired. */
static struct k_spinlock app_ble_lock;
static app_ble_conn_state_cb_t app_ble_state_cb;
static void *app_ble_state_cb_ctx;
static bool app_ble_initialized;

static void app_ble_notify_state(bool connected, uint8_t reason)
{
	if (app_ble_state_cb != NULL) {
		app_ble_state_cb(connected, reason, app_ble_state_cb_ctx);
	}
}

static void app_ble_connected(struct bt_conn *conn, uint8_t err)
{
	bool accepted = false;

	if (err != 0U) {
		LOG_ERR("Connection failed (err %u)", err);
		return;
	}

	{
		k_spinlock_key_t key = k_spin_lock(&app_ble_lock);

		if (app_ble_conn == NULL) {
			/* Ref held until app_ble_disconnected(); released there via bt_conn_unref(). */
			app_ble_conn = bt_conn_ref(conn);
			accepted = true;
		}

		/* Lock released before calling policy and notify to avoid
		 * holding the spinlock across BT-stack re-entrant calls. */
		k_spin_unlock(&app_ble_lock, key);
	}

	if (!accepted) {
		/* Only one connection is supported (CONFIG_BT_MAX_CONN=1).
		 * The extra connection is ignored; it will time out naturally. */
		LOG_WRN("Additional BLE connection ignored");
		return;
	}

	LOG_INF("Connected");
	app_ble_policy_on_connected(conn);
	app_ble_notify_state(true, 0U);
}

static void app_ble_disconnected(struct bt_conn *conn, uint8_t reason)
{
	struct bt_conn *to_unref = NULL;

	{
		k_spinlock_key_t key = k_spin_lock(&app_ble_lock);

		if ((app_ble_conn != NULL) && (app_ble_conn == conn)) {
			/* Defer bt_conn_unref() to after the spinlock is released.
			 * Calling it under the lock risks re-entrant BT-stack locking. */
			to_unref = app_ble_conn;
			app_ble_conn = NULL;
		}

		k_spin_unlock(&app_ble_lock, key);
	}

	if (to_unref != NULL) {
		app_ble_discovery_on_disconnected(conn, reason);
		app_ble_policy_on_disconnected(conn, reason);
		bt_conn_unref(to_unref);
		app_ble_notify_state(false, reason);
	}

	LOG_INF("Disconnected, reason %u %s", reason, bt_hci_err_to_str(reason));
}

static struct bt_conn_cb app_ble_conn_cbs = {
	.connected = app_ble_connected,
	.disconnected = app_ble_disconnected,
};

static void app_ble_auth_cancel(struct bt_conn *conn)
{
	char addr[BT_ADDR_LE_STR_LEN];

	bt_addr_le_to_str(bt_conn_get_dst(conn), addr, sizeof(addr));
	LOG_INF("Pairing cancelled: %s", addr);
}

static struct bt_conn_auth_cb app_ble_auth_cb = {
	.cancel = app_ble_auth_cancel,
};

int app_ble_handler_init(app_ble_conn_state_cb_t state_cb, void *state_cb_ctx)
{
	int rc;

	app_ble_state_cb = state_cb;
	app_ble_state_cb_ctx = state_cb_ctx;

	if (app_ble_initialized) {
		return 0;
	}

	bt_conn_cb_register(&app_ble_conn_cbs);

	rc = bt_conn_auth_cb_register(&app_ble_auth_cb);
	if ((rc != 0) && (rc != -EALREADY)) {
		LOG_ERR("Failed to register auth callback: %d", rc);
		return rc;
	}

	rc = app_ble_policy_init();
	if (rc != 0) {
		LOG_ERR("Failed to initialize BLE policy: %d", rc);
		return rc;
	}

	rc = app_ble_discovery_init(NULL, NULL);
	if (rc != 0) {
		LOG_ERR("Failed to initialize BLE discovery: %d", rc);
		return rc;
	}

	app_ble_initialized = true;
	return 0;
}

/* Safe to call from ISR context; uses a spinlock and never blocks. */
bool app_ble_handler_is_connected(void)
{
	bool connected;
	k_spinlock_key_t key = k_spin_lock(&app_ble_lock);

	connected = (app_ble_conn != NULL);

	k_spin_unlock(&app_ble_lock, key);
	return connected;
}

/* Caller must call bt_conn_unref() when done.
 * Returns -ENOTCONN if no connection is active, -EINVAL if conn is NULL. */
int app_ble_handler_conn_ref_get(struct bt_conn **conn)
{
	if (conn == NULL) {
		return -EINVAL;
	}

	*conn = NULL;

	{
		k_spinlock_key_t key = k_spin_lock(&app_ble_lock);

		if (app_ble_conn == NULL) {
			k_spin_unlock(&app_ble_lock, key);
			return -ENOTCONN;
		}

		/* Ref incremented under lock to prevent release between NULL check and bt_conn_ref(). */
		*conn = bt_conn_ref(app_ble_conn);

		k_spin_unlock(&app_ble_lock, key);
	}

	return 0;
}
```

## src/app_ble_handler.h
```c
/*
 * Copyright (c) 2026 Microchip Technology Inc.
 *
 * SPDX-License-Identifier: Apache-2.0
 */

#ifndef APP_BLE_HANDLER_H_
#define APP_BLE_HANDLER_H_

#include <stdbool.h>
#include <stdint.h>

#include <zephyr/bluetooth/conn.h>

typedef void (*app_ble_conn_state_cb_t)(bool connected, uint8_t reason, void *context);

int app_ble_handler_init(app_ble_conn_state_cb_t state_cb, void *state_cb_ctx);

bool app_ble_handler_is_connected(void);

int app_ble_handler_conn_ref_get(struct bt_conn **conn);

#endif /* APP_BLE_HANDLER_H_ */
```

## src/app_ble_policy.c
```c
/*
 * Copyright (c) 2026 Microchip Technology Inc.
 *
 * SPDX-License-Identifier: Apache-2.0
 */

#include <errno.h>

#include <zephyr/bluetooth/conn.h>
#include <zephyr/sys/util.h>

#include "app_ble_policy.h"

#include <zephyr/logging/log.h>
LOG_MODULE_REGISTER(app_ble_policy);

/* BT_SECURITY_L2: unauthenticated pairing with encryption (Just Works). */
#define APP_BLE_POLICY_SEC_LEVEL            BT_SECURITY_L2
#define APP_BLE_POLICY_CONN_INTERVAL_MIN    0x0006U
#define APP_BLE_POLICY_CONN_INTERVAL_MAX    0x0C80U
#define APP_BLE_POLICY_CONN_LATENCY_MAX     0x01F3U
#define APP_BLE_POLICY_CONN_TIMEOUT_MIN     0x000AU
#define APP_BLE_POLICY_CONN_TIMEOUT_MAX     0x0C80U

static bool app_ble_policy_initialized;

/* Reject conn param updates outside defined bounds. */
static bool app_ble_policy_le_param_req(struct bt_conn *conn, struct bt_le_conn_param *param)
{
	ARG_UNUSED(conn);

	if (param == NULL) {
		return false;
	}

	if ((param->interval_min < APP_BLE_POLICY_CONN_INTERVAL_MIN) ||
	    (param->interval_max > APP_BLE_POLICY_CONN_INTERVAL_MAX) ||
	    (param->interval_min > param->interval_max) ||
	    (param->latency > APP_BLE_POLICY_CONN_LATENCY_MAX) ||
	    (param->timeout < APP_BLE_POLICY_CONN_TIMEOUT_MIN) ||
	    (param->timeout > APP_BLE_POLICY_CONN_TIMEOUT_MAX)) {
		LOG_WRN("Rejecting conn params (itv %u-%u, lat %u, to %u)",
			param->interval_min, param->interval_max, param->latency,
			param->timeout);
		return false;
	}

	return true;
}

static void app_ble_policy_le_param_updated(struct bt_conn *conn, uint16_t interval,
					    uint16_t latency, uint16_t timeout)
{
	ARG_UNUSED(conn);

	LOG_INF("Conn params updated (itv %u, lat %u, to %u)", interval, latency, timeout);
}

#if defined(CONFIG_BT_SMP) || defined(CONFIG_BT_CLASSIC)
static void app_ble_policy_security_changed(struct bt_conn *conn, bt_security_t level,
					    enum bt_security_err err)
{
	ARG_UNUSED(conn);

	if (err == BT_SECURITY_ERR_SUCCESS) {
		LOG_INF("Security changed: level %u", level);
		return;
	}

	LOG_WRN("Security change failed: level %u, err %u", level, err);
}
#endif

static struct bt_conn_cb app_ble_policy_conn_cbs = {
	.le_param_req = app_ble_policy_le_param_req,
	.le_param_updated = app_ble_policy_le_param_updated,
#if defined(CONFIG_BT_SMP) || defined(CONFIG_BT_CLASSIC)
	.security_changed = app_ble_policy_security_changed,
#endif
};

#if defined(CONFIG_BT_SMP)
static void app_ble_policy_pairing_complete(struct bt_conn *conn, bool bonded)
{
	ARG_UNUSED(conn);

	LOG_INF("Pairing complete (bonded=%u)", bonded ? 1U : 0U);
}

static void app_ble_policy_pairing_failed(struct bt_conn *conn,
					  enum bt_security_err reason)
{
	ARG_UNUSED(conn);

	LOG_WRN("Pairing failed (reason=%u)", reason);
}

static void app_ble_policy_bond_deleted(uint8_t id, const bt_addr_le_t *peer)
{
	char addr[BT_ADDR_LE_STR_LEN];

	if (peer == NULL) {
		return;
	}

	bt_addr_le_to_str(peer, addr, sizeof(addr));
	LOG_INF("Bond deleted (id=%u, peer=%s)", id, addr);
}

static struct bt_conn_auth_info_cb app_ble_policy_auth_info_cb = {
	.pairing_complete = app_ble_policy_pairing_complete,
	.pairing_failed = app_ble_policy_pairing_failed,
	.bond_deleted = app_ble_policy_bond_deleted,
};
#endif

int app_ble_policy_init(void)
{
	int rc;

	if (app_ble_policy_initialized) {
		return 0;
	}

	bt_conn_cb_register(&app_ble_policy_conn_cbs);

#if defined(CONFIG_BT_SMP)
	rc = bt_conn_auth_info_cb_register(&app_ble_policy_auth_info_cb);
	if ((rc != 0) && (rc != -EALREADY)) {
		LOG_ERR("Failed to register auth-info callbacks: %d", rc);
		return rc;
	}
#endif

	app_ble_policy_initialized = true;
	return 0;
}

void app_ble_policy_on_connected(struct bt_conn *conn)
{
#if defined(CONFIG_BT_SMP)
	int rc;

	if (conn == NULL) {
		return;
	}

	rc = bt_conn_set_security(conn, APP_BLE_POLICY_SEC_LEVEL);
	if ((rc != 0) && (rc != -EALREADY)) {
		LOG_WRN("Security request failed: %d", rc);
	}
#else
	ARG_UNUSED(conn);
#endif
}

void app_ble_policy_on_disconnected(struct bt_conn *conn, uint8_t reason)
{
	ARG_UNUSED(conn);
	ARG_UNUSED(reason);
}
```

## src/app_ble_policy.h
```c
/*
 * Copyright (c) 2026 Microchip Technology Inc.
 *
 * SPDX-License-Identifier: Apache-2.0
 */

#ifndef APP_BLE_POLICY_H_
#define APP_BLE_POLICY_H_

#include <stdint.h>

#include <zephyr/bluetooth/conn.h>

int app_ble_policy_init(void);

void app_ble_policy_on_connected(struct bt_conn *conn);

void app_ble_policy_on_disconnected(struct bt_conn *conn, uint8_t reason);

#endif /* APP_BLE_POLICY_H_ */
```

## src/app_trsps_handler.c
```c
/*
 * Copyright (c) 2026 Microchip Technology Inc.
 *
 * SPDX-License-Identifier: Apache-2.0
 */

#include <zephyr/kernel.h>
#include <zephyr/net_buf.h>
#include <zephyr/bluetooth/conn.h>
#include <zephyr/drivers/uart.h>
#include <zephyr/sys/check.h>

#include <zephyr/bluetooth/services/trs/trs_server.h>
#include "app_trsps_handler.h"

#include <zephyr/logging/log.h>
LOG_MODULE_REGISTER(app_trsps_handler);

#define APP_TRSPS_BUF_POOL_SIZE      CONFIG_TRS_SERVER_BUF_POOL_SIZE
#define APP_TRSPS_BUF_DATA_SIZE      CONFIG_TRS_SERVER_BUF_DATA_SIZE
#define APP_TRSPS_RX_CONN_QUEUE_LEN  (CONFIG_BT_MAX_CONN * 4U)

/* Pool sized to match TRS_SERVER_CREDIT so each in-flight CBFC credit slot
 * can hold one buffer.  K_FOREVER allocs in the work queue will block if all
 * buffers are held by a stalled UART TX path, stalling all other work items. */
NET_BUF_POOL_DEFINE(ble_to_uart_buf_pool, APP_TRSPS_BUF_POOL_SIZE,
		    APP_TRSPS_BUF_DATA_SIZE, 0, NULL);

/* BLE→UART direction:
 * Producer: work-queue context (ble_to_uart_enqueue, protected by irq_lock).
 * Consumer: ISR context (app_trsps_handler_ble_to_uart_service, K_NO_WAIT). */
static K_FIFO_DEFINE(ble_to_uart_fifo);

/* Passes bt_conn references from BT RX thread to the BLE→UART work queue.
 * Each entry holds a ref that the work-queue consumer must release. */
K_MSGQ_DEFINE(ble_rx_conn_msgq, sizeof(struct bt_conn *),
	      APP_TRSPS_RX_CONN_QUEUE_LEN, sizeof(void *));

/* [work-queue context] BLE→UART drain work. */
static struct k_work ble_to_uart_work;
static const struct device *app_trsps_uart_dev;
static app_trsps_uart_to_ble_ready_cb_t uart_to_ble_ready_cb;
static void *uart_to_ble_ready_cb_ctx;
static bool app_trsps_initialized;

/* [BT RX thread] Invoke UART→BLE ready callback. */
static void trigger_uart_to_ble_pump(void)
{
	if (uart_to_ble_ready_cb != NULL) {
		uart_to_ble_ready_cb(uart_to_ble_ready_cb_ctx);
	}
}

/* Enqueue BLE→UART buffer; enable TX IRQ on empty→non-empty transition. [work-queue context] */
static void ble_to_uart_enqueue(struct net_buf *buf)
{
	unsigned int key;
	bool was_empty;

	if (buf == NULL) {
		return;
	}

	/* irq_lock() rather than spinlock: the consumer runs in ISR context.
	 * The critical section covers the empty check and tx_enable together
	 * to prevent enabling the IRQ before the buffer is visible to the ISR. */
	key = irq_lock();
	was_empty = k_fifo_is_empty(&ble_to_uart_fifo);
	k_fifo_put(&ble_to_uart_fifo, buf);
	if (was_empty && (app_trsps_uart_dev != NULL)) {
		/* Enable TX interrupt only on the empty→non-empty transition.
		 * The ISR disables it again when the FIFO drains to avoid a busy loop. */
		uart_irq_tx_enable(app_trsps_uart_dev);
	}
	irq_unlock(key);
}

/* [work-queue context] Drain BLE receive queue for conn to UART. */
static void ble_to_uart_drain_conn(struct bt_conn *conn)
{
	while (true) {
		uint16_t data_len;
		int copied_len;
		struct net_buf *buf;

		trs_server_get_data_len(conn, &data_len);
		if (data_len == 0U) {
			return;
		}

		/* K_FOREVER: blocks the work queue until a buffer is available.
		 * If the UART TX path is stalled, this will stall all other work items
		 * on the system queue.  Pool depth matches CBFC credit count to bound
		 * the maximum outstanding allocation. */
		buf = net_buf_alloc_len(&ble_to_uart_buf_pool, (size_t)data_len, K_FOREVER);
		if (buf == NULL) {
			LOG_ERR("BLE->UART: no buffer for %u-byte payload", data_len);
			return;
		}

		/* net_buf_add → write pointer; trs_server_get_data copies and updates CBFC credits. */
		copied_len = trs_server_get_data(conn, net_buf_add(buf, (size_t)data_len));
		if (copied_len <= 0) {
			net_buf_unref(buf);
			return;
		}

		ble_to_uart_enqueue(buf);
	}
}

static void ble_to_uart_work_handler(struct k_work *work)
{
	struct bt_conn *conn;

	ARG_UNUSED(work);

	while (k_msgq_get(&ble_rx_conn_msgq, &conn, K_NO_WAIT) == 0) {
		ble_to_uart_drain_conn(conn);
		/* Release the ref taken in trs_event_handler(). */
		bt_conn_unref(conn);
	}
}

/* [BT RX thread] TRS server event dispatcher. */
static void trs_event_handler(struct trs_server_event *event)
{
	struct bt_conn *conn_ref;

	if (event == NULL) {
		return;
	}

	switch (event->event_id) {
	case TRS_SERVER_EVT_RECEIVE_DATA:
		/* BLE→UART direction: BLE Central wrote data; queue conn ref for work-queue processing. */
		if (event->event_field.conn == NULL) {
			break;
		}

		/* Take a ref before posting to the queue; the event pointer is
		 * valid only for the duration of this callback. */
		conn_ref = bt_conn_ref(event->event_field.conn);
		if (k_msgq_put(&ble_rx_conn_msgq, &conn_ref, K_NO_WAIT) != 0) {
			/* Queue full: release the ref immediately to avoid a leak.
			 * The receive event is dropped; BLE data for this packet is lost. */
			bt_conn_unref(conn_ref);
			LOG_WRN("BLE->UART: ble_rx_conn_msgq full, dropping receive event");
			break;
		}

		k_work_submit(&ble_to_uart_work);
		break;

	case TRS_SERVER_EVT_CTRL_STATUS:
		LOG_INF("Control point status: %s",
			(event->event_field.ctrl_status.status == TRS_SERVER_STATUS_CTRL_OPENED)
				? "opened"
				: "disabled");
		break;

	case TRS_SERVER_EVT_TX_STATUS:
		/* UART→BLE channel state changed (Central wrote TX CCCD). */
		LOG_INF("UART->BLE TX channel: %s",
			(event->event_field.tx_status.status == TRS_SERVER_STATUS_TX_OPENED)
				? "opened"
				: "disabled");
		if (event->event_field.tx_status.status == TRS_SERVER_STATUS_TX_OPENED) {
			trigger_uart_to_ble_pump();
		}
		break;

	case TRS_SERVER_EVT_CBFC_ENABLED:
		LOG_INF("CBFC BLE->UART Rx enabled");
		break;

	case TRS_SERVER_EVT_CBFC_CREDIT:
		/* UART→BLE direction: peer granted more TX credits; resume sending. */
		LOG_INF("CBFC UART->BLE Tx credit updated");
		trigger_uart_to_ble_pump();
		break;

	case TRS_SERVER_EVT_VENDOR_CMD:
		LOG_INF("Vendor command received (length = %d)",
			event->event_field.vendor_cmd.length);
		break;

	case TRS_SERVER_EVT_ERR_UNSPECIFIED:
		LOG_INF("TRS unspecified error");
		break;

	case TRS_SERVER_EVT_ERR_NO_MEM:
		LOG_INF("TRS no memory");
		break;

	default:
		break;
	}
}

static struct trs_server_cb trs_evt_cb = {
	.trs_server_event = trs_event_handler,
};

int app_trsps_handler_init(const struct device *uart_dev,
			   app_trsps_uart_to_ble_ready_cb_t uart_to_ble_ready_cb_arg,
			   void *uart_to_ble_ready_cb_ctx_arg)
{
	int err;

	/* NULL uart_dev would crash uart_irq_tx_enable() in the TX ISR path. */
	if (uart_dev == NULL) {
		return -EINVAL;
	}

	/* trs_server_cb_register() must not be called twice; node insertion is not idempotent. */
	if (app_trsps_initialized) {
		return 0;
	}

	app_trsps_uart_dev       = uart_dev;
	uart_to_ble_ready_cb     = uart_to_ble_ready_cb_arg;
	uart_to_ble_ready_cb_ctx = uart_to_ble_ready_cb_ctx_arg;

	/* Submitted later by trs_event_handler() on each BLE packet arrival. */
	k_work_init(&ble_to_uart_work, ble_to_uart_work_handler);

	err = trs_server_cb_register(&trs_evt_cb);
	if (err != 0) {
		return err;
	}

	app_trsps_initialized = true;
	return 0;
}

/* [ISR context] Service UART TX: drain ble_to_uart_fifo one net_buf at a time. */
void app_trsps_handler_ble_to_uart_service(void)
{
	/* static: persists across ISR calls so a partially-written buffer
	 * is resumed on the next TX-ready interrupt without re-queuing. */
	static struct net_buf *ble_to_uart_buf;
	int len;

	if (app_trsps_uart_dev == NULL) {
		return;
	}

	if (ble_to_uart_buf == NULL) {
		ble_to_uart_buf = k_fifo_get(&ble_to_uart_fifo, K_NO_WAIT);
		if (ble_to_uart_buf == NULL) {
			/* FIFO is empty; disable TX interrupt until next BLE→UART data arrives.
			 * ble_to_uart_enqueue() re-enables it on next data. */
			uart_irq_tx_disable(app_trsps_uart_dev);
			return;
		}
	}

	len = uart_fifo_fill(app_trsps_uart_dev, ble_to_uart_buf->data, ble_to_uart_buf->len);
	net_buf_pull(ble_to_uart_buf, len);
	if (ble_to_uart_buf->len == 0U) {
		/* Buffer fully consumed; return it to the pool.  This may unblock
		 * a K_FOREVER alloc waiting in ble_to_uart_drain_conn(). */
		net_buf_unref(ble_to_uart_buf);
		ble_to_uart_buf = NULL;
	}
}
```

## src/app_trsps_handler.h
```c
/*
 * Copyright (c) 2026 Microchip Technology Inc.
 *
 * SPDX-License-Identifier: Apache-2.0
 */

#ifndef APP_TRSPS_HANDLER_H_
#define APP_TRSPS_HANDLER_H_

#include <zephyr/drivers/uart.h>

/** Callback invoked when the UART→BLE channel becomes ready to accept data.
 *  Fired when the BLE Central enables TX notifications (CCCD) or grants CBFC credits. */
typedef void (*app_trsps_uart_to_ble_ready_cb_t)(void *context);

int app_trsps_handler_init(const struct device *uart_dev,
                           app_trsps_uart_to_ble_ready_cb_t uart_to_ble_ready_cb,
                           void *uart_to_ble_ready_cb_ctx);

/** Services the BLE→UART UART TX path from within the UART TX-ready ISR. */
void app_trsps_handler_ble_to_uart_service(void);

#endif /* APP_TRSPS_HANDLER_H_ */
```
