/*
 * Copyright (c) 2026 Microchip Technology Inc.
 *
 * SPDX-License-Identifier: Apache-2.0
 */
/ {
	chosen {
		/* Use XDS110 UART for the NCP */
		zephyr,ot-uart = &sercom0;
		/* Use UART1 for debugging / zephyr console */
		//zephyr,shell-uart = &uart1;
		//zephyr,console = &uart1;
	};
};

&sercom0{                   
	status = "okay";
};

//&uart1 {
//	status = "okay";
//};