/*
 * Copyright (c) 2025 Microchip Technology Inc.
 * SPDX-License-Identifier: Apache-2.0
 */

/ {
	aliases {
		mspi0 = &qspi0;
	};
};

&qspi0 {
	mspi_flash0: mspi-flash0@0 {
		status = "okay";
		compatible = "zephyr,mspi-emul-device";
	};
};
