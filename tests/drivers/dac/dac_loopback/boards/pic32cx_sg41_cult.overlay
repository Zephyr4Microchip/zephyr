/*
 * Copyright (c) 2026 Microchip Technology Inc.
 *
 * SPDX-License-Identifier: Apache-2.0
 */

/* DAC0 internally connected to ADC channel 30*/

&dac {
	status = "okay";
	refsel = "vdd_ana";
	#address-cells = <1>;
	#size-cells = <0>;

	dac0: channel@0 {
		reg = <0>;
		rate = <1000>;
		data-adj = "right";
	};
};

&adc0 {
	status = "okay";
	prescaler = <16>;
};
