/*
 * Copyright (c) 2026 Microchip Technology Inc.
 *
 * SPDX-License-Identifier: Apache-2.0
 */

/*connect the PA06 to PA07 for the test*/

/ {
	resources {
		compatible = "test-gpio-basic-api";
		out-gpios = <&porta 6 0>; /* EXT1.5 */
		in-gpios = <&porta 7 0>;  /* EXT1.6 */
	};
};

&porta {
	status = "okay";
};
