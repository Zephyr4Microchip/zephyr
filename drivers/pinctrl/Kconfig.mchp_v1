## dts/bindings/clock/microchip,sam-d5x-e5x-gclkgen.yaml
```yaml
# Copyright (c) 2025 Microchip Technology Inc.
# SPDX-License-Identifier: Apache-2.0

include: [base.yaml]

description: gclk generator configuration.
compatible: "microchip,sam-d5x-e5x-gclkgen"

child-binding:
  properties:
    subsystem:
      type: int
      required: true
      description: Clock subsystem

    gclkgen_div_factor:
      type: int
      default: 0
      description: |
        Represent a division value for the corresponding Generator. The actual division factor is
        dependent on the state of div_select (gclk1 0 - 65535, others 0 - 255)

    gclkgen_run_in_standby_en:
      type: int
      enum:
        - 0
        - 1
      default: 0
      description: |
        Keep the Generator running in Standby as long as it is configured to output to a dedicated
        GCLK_IOn pin. If output is not configured to a pin, this field has no effect and the
        generator will only be running if a peripheral requires the clock.

    gclkgen_div_select:
      type: string
      enum:
        - "div-factor"
        - "div-factor-power"
      default: "div-factor"
      description: |
        The Generator clock frequency equals the clock source frequency divided by div_factor
        DIV_FACTOR_POWER: The Generator clock frequency equals the clock source frequency divided
        by 2^(N+1), where N is the div_factor

    gclkgen_pin_output_en:
      type: int
      enum:
        - 0
        - 1
      default: 0
      description: |
        Generator clock output to the corresponding pin, if that pin is not configured as input
        source.

    gclkgen_pin_output_off_val:
      type: string
      enum:
        - "low"
        - "high"
      default: "low"
      description: |
        Output value of the corresponding pin, when the Generator is turned off or the output_en is
        false, as long as the pin is not source.

    gclkgen_duty_50_50_en:
      type: int
      enum:
        - 0
        - 1
      default: 0
      description: Improve the duty cycle of the Generator output to 50/50 for odd division factors

    gclkgen_en:
      type: int
      enum:
        - 0
        - 1
      default: 0
      description: Enable gclk generator

    gclkgen_src:
      type: string
      enum:
        - "xosc0"
        - "xosc1"
        - "gclk-pin"
        - "gclk1"
        - "osculp32k"
        - "osc32k"
        - "dfll"
        - "fdpll0"
        - "fdpll1"
      default: "xosc0"
      description: Generator source clock selection

    gclkgen_pin_src_freq:
      type: int
      default: 0
      description: External input clock frequency of the pin, when used as source. (0 - 200000000)
```

## dts/bindings/clock/microchip,sam-d5x-e5x-gclkperiph.yaml
```yaml
# Copyright (c) 2025 Microchip Technology Inc.
# SPDX-License-Identifier: Apache-2.0

include: [base.yaml]

description: peripheral channel gclk clock configuration.
compatible: "microchip,sam-d5x-e5x-gclkperiph"

properties:
  "#clock-cells":
    const: 1
    type: int

clock-cells:
  - subsystem
```

## dts/bindings/clock/microchip,sam-d5x-e5x-mclk.yaml
```yaml
# Copyright (c) 2025 Microchip Technology Inc.
# SPDX-License-Identifier: Apache-2.0

description: Microchip SAM D5x/E5x Generic Clock Controller (MCLK)

compatible: "microchip,sam-d5x-e5x-mclk"

include: [clock-controller.yaml, base.yaml]

clock-cells:
  - id

properties:
  reg:
    required: true

  "#clock-cells":
    const: 1
```

## dts/bindings/clock/microchip,sam-d5x-e5x-mclkcpu.yaml
```yaml
# Copyright (c) 2025 Microchip Technology Inc.
# SPDX-License-Identifier: Apache-2.0

include: [base.yaml]

description: |
  Main Clock (MCLK) configuration for CPU clock.

compatible: "microchip,sam-d5x-e5x-mclkcpu"

properties:
  mclk-cpu-div:
    type: int
    enum:
      - 1
      - 2
      - 4
      - 8
      - 16
      - 32
      - 64
      - 128
    default: 1
    description: |
      CPU Clock Division Factor
```

## dts/bindings/clock/microchip,sam-d5x-e5x-mclkperiph.yaml
```yaml
# Copyright (c) 2025 Microchip Technology Inc.
# SPDX-License-Identifier: Apache-2.0

include: [base.yaml]

description: Main Clock (MCLK) configuration for peripheral AHB and APB clocks.
compatible: "microchip,sam-d5x-e5x-mclkperiph"

properties:
  "#clock-cells":
    const: 1
    type: int

clock-cells:
  - subsystem

child-binding:
  properties:
    subsystem:
      type: int
      required: true
      description: Clock subsystem
    mclk_en:
      type: int
      enum:
        - 0
        - 1
      required: true
      description: Enable mclk to the peripheral
```

## dts/bindings/clock/microchip,sam-d5x-e5x-osc32k.yaml
```yaml
# Copyright (c) 2025 Microchip Technology Inc.
# SPDX-License-Identifier: Apache-2.0

include: [base.yaml]

description: 32KHz Oscillators Controller configuration.
compatible: "microchip,sam-d5x-e5x-osc32k"

properties:
  osc32k_gain_mode:
    type: string
    enum:
      - "standard"
      - "highspeed"
    default: "standard"
    description: control the gain of the external crystal oscillator

  osc32k_write_lock_en:
    type: int
    enum:
      - 0
      - 1
    default: 0
    description: Locks the XOSC32K register for future writes

  osc32k_startup_time:
    type: int
    enum:
      - 62
      - 125
      - 500
      - 1000
      - 2000
      - 4000
      - 8000
    default: 62
    description: Oscillator Start-Up Time in ms

  osc32k_on_demand_en:
    type: int
    enum:
      - 0
      - 1
    default: 0
    description: |
      0: The oscillator is always on, if standby_en is true, else run in
         Standby Sleep mode if requested by a peripheral.
      1: Run if requested by peripheral
      Important: Initializing it with 1, along with clock enabled, can lead to indefinite wait for
      the clock to be on, if there is no peripheral request for the clock in the sequence of clock
      Initialization. If required, better to turn on the clock using API, instead of enabling both
      during startup.

  osc32k_run_in_standby_en:
    type: int
    enum:
      - 0
      - 1
    default: 0
    description: |
      0: Run if requested by peripheral
      1: The oscillator is always on, if demand_en is false

  osc32k_1khz_en:
    type: int
    enum:
      - 0
      - 1
    default: 0
    description: 1kHz Output Enable

  osc32k_32khz_en:
    type: int
    enum:
      - 0
      - 1
    default: 0
    description: 32kHz output is enable

  osc32k_xtal_en:
    type: int
    enum:
      - 0
      - 1
    default: 0
    description: |
      Selects external clock or crystal oscillator
      0 - External clock connected on XIN. XOUT can be used as general-purpose I/O.
      1 - Crystal connected to XIN/XOUT.

  osc32k_en:
    type: int
    enum:
      - 0
      - 1
    default: 0
    description: Oscillator Enable

  osc32k_cf_backup_divideby2_en:
    type: int
    enum:
      - 0
      - 1
    default: 0
    description: The CFD safe clock frequency is the OSCULP32K frequency divided by 2

  osc32k_switch_back_en:
    type: int
    enum:
      - 0
      - 1
    default: 0
    description: |
      Controls the XOSC32K output switch back to the external clock or crystal scillator in case of
      clock recovery

  osc32k_cfd_en:
    type: int
    enum:
      - 0
      - 1
    default: 0
    description: Clock Failure Detector Enable

  osculp32k_write_lock_en:
    type: int
    enum:
      - 0
      - 1
    default: 0
    description: Locks the OSCULP32K register for future writes

  osculp32k_1khz_en:
    type: int
    enum:
      - 0
      - 1
    default: 1
    description: 1kHz Output Enable

  osculp32k_32khz_en:
    type: int
    enum:
      - 0
      - 1
    default: 1
    description: 32kHz output is enable
```

## dts/bindings/clock/microchip,sam-d5x-e5x-osc32kctrl.yaml
```yaml
# Copyright (c) 2025 Microchip Technology Inc.
# SPDX-License-Identifier: Apache-2.0

description: Microchip SAM D5x/E5x OSC32KCTRL Clock Controller (OSC32KCTRL)

compatible: "microchip,sam-d5x-e5x-osc32kctrl"

include: [clock-controller.yaml, base.yaml]

clock-cells:
  - id

properties:
  reg:
    required: true

  "#clock-cells":
    const: 1

  xosc32k_frequency:
    type: int
    description: Crystal/External clock
      frequency for XOSC32K Controller
    default: 32768
```

## dts/bindings/clock/microchip,sam-d5x-e5x-oscctrl.yaml
```yaml
# Copyright (c) 2025 Microchip Technology Inc.
# SPDX-License-Identifier: Apache-2.0

description: Microchip SAM D5x/E5x OSCCTRL Clock Controller (OSCCTRL)

compatible: "microchip,sam-d5x-e5x-oscctrl"

include: [clock-controller.yaml, base.yaml]

clock-cells:
  - id

properties:
  reg:
    required: true

  "#clock-cells":
    const: 1

  dfll_frequency:
    type: int
    description: Output Clock frequency of DPLL Controller
    default: 48000000

  xosc_frequency:
    type: int
    description: Crystal/External clock frequency for
      XOSC Controller
    default: 24000000
```
