## drivers/pinctrl/Kconfig.mchp_v1
```kconfig
# Copyright (c) 2025 Microchip Technology Inc.
# SPDX-License-Identifier: Apache-2.0

config PINCTRL_MCHP_V1
	bool "Microchip SAM D5x/E5x pin controller driver"
	default y
	depends on DT_HAS_MICROCHIP_SAM_D5X_E5X_PINCTRL_ENABLED
	help
	  Microchip pin controller driver is used on SAM D5x/E5x family
```

## drivers/pwm/Kconfig.mchp
```kconfig
# Copyright (c) 2025 Microchip Technology Inc.
# SPDX-License-Identifier: Apache-2.0

menu "Microchip PWM Drivers"

config PWM_MCHP_G1_TC
	bool "Microchip TC G1 PWM driver"
	default y

	depends on  DT_HAS_MICROCHIP_TC_G1_PWM_ENABLED
	select PINCTRL
	help
	  Enable the Microchip Pulse Width Modulation(PWM) driver.
	  This driver supports Microchip device families:
	  - SOC_FAMILY_MCHP_SAM_D5X_E5X
endmenu
```

## drivers/reset/Kconfig.mchp
```kconfig
# Copyright (c) 2025 Microchip Technology Inc.
# SPDX-License-Identifier: Apache-2.0

config RESET_MCHP_RSTC_G1
	bool "Microchip Reset Controller g1 peripheral driver"
	default y
	depends on DT_HAS_MICROCHIP_RSTC_G1_RESET_ENABLED
	help
	  Enable RESET driver for Microchip G1 IPs.


config RESET_MCHP_RCON_G1
	bool "Microchip Reset Controller RCON_G1 driver"
	default y
	depends on DT_HAS_MICROCHIP_RCON_G1_RESET_ENABLED
	help
	  Enable RESET driver for Microchip RCON G1 IPs.
```

## drivers/rtc/Kconfig.mchp
```kconfig
#Copyright (c) 2025 Microchip Technology Inc.
#SPDX-License-Identifier: Apache-2.0

config RTC_MCHP_G1
	bool "Microchip RTC driver for RTC_G1 IP"
	default y
	depends on DT_HAS_MICROCHIP_RTC_G1_ENABLED
	help
	  Enable RTC driver for Microchip G1 IPs.
```

## drivers/serial/Kconfig.mchp
```kconfig
# Copyright (c) 2025 Microchip Technology Inc.
# SPDX-License-Identifier: Apache-2.0

config UART_MCHP_SERCOM_G1
	bool "Microchip SERCOM G1 UART driver"
	default y
	depends on DT_HAS_MICROCHIP_SERCOM_G1_UART_ENABLED
	select SERIAL_HAS_DRIVER
	select SERIAL_SUPPORT_INTERRUPT
	select SERIAL_SUPPORT_ASYNC
	select PINCTRL
	help
	  This option enables UART driver support for SERCOM group 1 (G1) peripherals.

config UART_MCHP_ASYNC
	bool "Async UART support for Microchip UART Peripheral"
	depends on UART_MCHP_SERCOM_G1
	depends on UART_ASYNC_API
	depends on DMA
```

## drivers/serial/Kconfig.mchp_v1
```kconfig
# Copyright (c) 2025 Microchip Technology Inc.
# SPDX-License-Identifier: Apache-2.0

config UART_MCHP_V1
    bool "Microchip MCHP_V1 SERCOM UART driver"
    default y
    depends on DT_HAS_MICROCHIP_SERCOM_U2201_UART_ENABLED
    select SERIAL_HAS_DRIVER
    select SERIAL_SUPPORT_INTERRUPT
    select SERIAL_SUPPORT_ASYNC
    select PINCTRL
    help
      This option enables the USART driver for Microchip sercom-u2201 IP.

config UART_MCHP_ASYNC
    bool "Async UART support for Microchip SAME54 series."
    depends on DMA_MCHP_V1
    depends on UART_MCHP_V1
    depends on UART_ASYNC_API
```

## drivers/spi/Kconfig.mchp_v1
```kconfig
# Microchip SAM SPI

# Copyright (c) 2025 Microchip Technology Inc.
# SPDX-License-Identifier: Apache-2.0

config SPI_MCHP_V1
	bool "Microchip MCHP V1 series SERCOM SPI driver"
	default y
	depends on DT_HAS_MICROCHIP_SERCOM_U2201_SPI_ENABLED
	select DMA if SPI_ASYNC
	help
	  Enable support for the Microchip MCHP V1 series SERCOM SPI driver.

config SPI_MCHP_INTERRUPT_DRIVEN
	bool "Microchip MCHP V1 series SERCOM SPI driver (Interrupt Driven)"
	depends on SPI_MCHP_V1 && !SPI_ASYNC
	help
	  Enable interrupt-driven support for the Microchip MCHP V1 series
	  SERCOM SPI driver.

menu "SPI ASYNC SELECTION"
	depends on SPI_MCHP_V1 && SPI_ASYNC

choice
	prompt "Select Async Mode: Interrupt or DMA"
	default SPI_MCHP_INTERRUPT_DRIVEN_ASYNC
	help
	  Choose between interrupt or DMA async mode for the MCHP SPI driver.

config SPI_MCHP_INTERRUPT_DRIVEN_ASYNC
	bool "MCHP Interrupt Async"
	help
	  Enables interrupt support for the MCHP SPI driver in async mode.

config SPI_MCHP_DMA_DRIVEN
	bool "MCHP DMA"
	help
	  Enables DMA support for the MCHP SPI driver.

endchoice
endmenu
```

## drivers/watchdog/Kconfig.mchp_v1
```kconfig
# Copyright (c) 2025 Microchip Technology Inc.
# SPDX-License-Identifier: Apache-2.0

config WDT_MCHP_V1
	bool "Microchip MCHP V1 series Watchdog (WDT) Driver"
	default y
	depends on DT_HAS_MICROCHIP_WDT_U2251_ENABLED
	select HAS_WDT_DISABLE_AT_BOOT
	help
	  Enable WDT driver for Microchip MCHP V1 series.
```

## dts/bindings/adc/microchip,adc-u2500.yaml
```yaml
# Copyright (c) 2025 Microchip Technology Inc.
# SPDX-License-Identifier: Apache-2.0

description: |
  Microchip ADC peripheral binding. Includes support for selecting the ADC input clock
  prescaler, vref-mv, clocks and interrupts.

compatible: "microchip,adc-u2500"

include:
  - name: adc-controller.yaml
  - name: pinctrl-device.yaml

properties:
  reg:
    required: true
    description: Register base address and size for the ADC peripheral.

  interrupts:
    required: true
    description: Interrupt specifier for the ADC peripheral.

  clocks:
    required: true
    description: Clock phandles used to drive the ADC.

  clock-names:
    required: true
    description: Clock name corresponding to the `clocks` entry.

  vref-mv:
    type: int
    description: |
      ADC reference voltage in millivolts.
      This should match the reference selected in hardware or software config.

  prescaler:
    type: int
    required: true
    enum: [2, 4, 8, 16, 32, 64, 128, 256]
    description: |
      Clock prescaler value. Must be a power of 2 between 2 and 256 inclusive.
      The ADC clock is derived by dividing the source clock by this prescaler.

  num-channels:
    type: int
    required: true
    default: 23
    description: |
      Number of ADC input channels supported by the hardware instance.

  "#io-channel-cells":
    const: 1
    description: Specifies that each io-channel uses a single cell (input index).

  calib-offset:
    type: int
    enum: [0, 14]
    description: |
      Bit offset of the BIASCOMP field in NVM software calibration region.
      Typically 0 for ADC0 and 14 for ADC1. Used on SAMD5x/E5x SoCs.

io-channel-cells:
  - input
```

## dts/bindings/arm/microchip,same54-sercom.yaml
```yaml
# Copyright (c) [2025] [Microchip Technology Inc.]
# SPDX-License-Identifier: Apache-2.0

description: Microchip SAME54 multi-protocol (UART, SPI, I2C) SERCOM unit

compatible: "microchip,same54-sercom"

include: base.yaml

properties:
  reg:
    required: true

  interrupts:
    required: true

  clocks:
    required: true
```

## dts/bindings/arm/microchip,sercom-u2201.yaml
```yaml
# Copyright (c) 2025 Microchip Technology Inc.
# SPDX-License-Identifier: Apache-2.0

description: Microchip SERCOM-u2201 multi-protocol (UART, SPI, I2C) SERCOM unit

compatible: "microchip,sercom-u2201"

include: base.yaml

properties:
  reg:
    required: true

  interrupts:
    required: true

  clocks:
    required: true
```

## dts/bindings/arm/microchip,tc-g1.yaml
```yaml
# Copyright (c) 2025 Microchip Technology Inc.
# SPDX-License-Identifier: Apache-2.0

description: |
  Microchip TC g1 peripherals are used for creating the PWM output on different channels
  as well as used as a timer/counter.
  This yaml supports the following peripherals
    - tc-u2249

compatible: "microchip,tc-g1"

# Include common properties from base.yaml and pinctrl-device.yaml
include:
  - name: base.yaml
  - name: pinctrl-device.yaml

properties:
  reg:
    description: |
      Specifies the base address and size of the register set for the timer counter peripheral.
    required: true

  interrupts:
    description: |
      Defines the interrupt lines used by the timer counter peripheral. This property
      specifies the interrupt number and priority.
    required: true

  clocks:
    description: |
      Specifies the clock sources and their configurations for the timer counter peripheral.
      This property ensures the peripheral is provided with the necessary clock signals.
      The following are the clock names applicable to this property.
       - mclk
       - gclk
       - client_mclk : This is the clock subsystem of the client with
         which the instance can be paired
    required: true

  prescaler:
    type: int
    description: |
      Timer prescaler values. The prescaler divides the input clock frequency to
      achieve the desired timer frequency. Common prescaler values include 1, 2,
      4, 8, 16, 64, 256, and 1024.
    enum:
      - 1
      - 2
      - 4
      - 8
      - 16
      - 64
      - 256
      - 1024
```

## dts/bindings/arm/microchip,tcc-u2213.yaml
```yaml
# Copyright (c) 2025 Microchip Technology Inc.
# SPDX-License-Identifier: Apache-2.0

description: >
  Microchip TCC-U2213 timer counter peripheral. This peripheral is used for
  generating PWM signals.

compatible: "microchip,tcc-u2213"

# Include common properties from base.yaml and pinctrl-device.yaml
include:
  - name: base.yaml
  - name: pinctrl-device.yaml

properties:
  reg:
    description: >
      Specifies the base address and size of the register set for the timer counter peripheral.
    required: true

  interrupts:
    description: >
      Defines the interrupt lines used by the timer counter peripheral. This property
      specifies the interrupt number and priority.
    required: true

  clocks:
    description: >
      Specifies the clock sources and their configurations for the timer counter peripheral.
      This property ensures the peripheral is provided with the necessary clock signals.
    required: true

  prescaler:
    type: int
    description: >
      Timer prescaler values. The prescaler divides the input clock frequency to
      achieve the desired timer frequency. Common prescaler values include 1, 2,
      4, 8, 16, 64, 256, and 1024.
    enum:
      - 1
      - 2
      - 4
      - 8
      - 16
      - 64
      - 256
      - 1024

  instance-id:
    type: int
    required: true
    description: >
      Unique identifier indicating the sequence or instance number of the peripheral.
      This is primarily used for scenarios like chaining peripherals (e.g., for 32-bit
      PWM or counter operation). The value determines the peripheral's position in
      the chaining hierarchy.
```

## dts/bindings/bluetooth/microchip,pic32cx-bz-bt-hci.yaml
```yaml
# Copyright (c) 2025 Microchip Technology Inc.
# SPDX-License-Identifier: Apache-2.0

description: Microchip HCI Bluetooth driver

compatible: "microchip,pic32cx-bz-bt-hci"

include: bt-hci.yaml

properties:
  bt-hci-name:
    default: "MCHP PIC32CX BZ BT HCI"
  bt-hci-bus:
    default: "virtual"
  bt-hci-quirks:
    default: ["no-reset"]
```

## dts/bindings/clock/microchip,sam-d5x-e5x-clock.yaml
```yaml
# Copyright (c) 2025 Microchip Technology Inc.
# SPDX-License-Identifier: Apache-2.0

description: Microchip SAM D5x/E5x Clock System (OSCCTRL, OSC32KCTRL, MCLK, GCLK)

compatible: "microchip,sam-d5x-e5x-clock"

include: [clock-controller.yaml, base.yaml]

clock-cells:
  - id

properties:

  "#clock-cells":
    const: 1
```

## dts/bindings/clock/microchip,sam-d5x-e5x-fdpll.yaml
```yaml
# Copyright (c) 2025 Microchip Technology Inc.
# SPDX-License-Identifier: Apache-2.0

include: [base.yaml]

description: Digital Phase Locked Loop (FDPLL200Mn) configuration.
compatible: "microchip,sam-d5x-e5x-fdpll"

child-binding:
  properties:
    subsystem:
      type: int
      required: true
      description: Clock subsystem

    fdpll_on_demand_en:
      type: int
      enum:
        - 0
        - 1
      default: 0
      description: |
        0: The oscillator is always on
        1: The oscillator is running when a peripheral is requesting the oscillator to be used as a
        clock source. The oscillator is not running if no peripheral is requesting the clock source.
        Important: Initializing it with 1, along with clock enabled, can lead to indefinite wait
        for the clock to be on, if there is no peripheral request for the clock in the sequence of
        clock Initialization. If required, better to turn on the clock using API, instead of
        enabling both during startup.

    fdpll_run_in_standby_en:
      type: int
      enum:
        - 0
        - 1
      default: 0
      description: |
        0: The DPLLn is not running in standby sleep mode if no peripheral requests the clock.
        1: The DPLLn is running in standby sleep mode.
        If ONDEMAND is one, the DPLLn will be running when a peripheral is requesting the clock. If
        ONDEMAND is false, the clock source will always be running in standby sleep mode.

    fdpll_en:
      type: int
      enum:
        - 0
        - 1
      default: 0
      description: Oscillator Enable

    fdpll_divider_ratio_int:
      type: int
      default: 0
      description: Set the integer part of the frequency multiplier. (0 - 4095)

    fdpll_divider_ratio_frac:
      type: int
      default: 0
      description: Set the fractional part of the frequency multiplier. (0 - 31)

    fdpll_xosc_clock_divider:
      type: int
      default: 0
      description: Set the XOSC clock division factor (0 - 2047)

    fdpll_dco_en:
      type: int
      enum:
        - 0
        - 1
      default: 0
      description: DCO Filter Enable

    fdpll_dco_filter_select:
      type: string
      enum:
        - "3.21mhz"
        - "1.6mhz"
        - "1.1mhz"
        - "0.8mhz"
        - "0.64mhz"
        - "0.55mhz"
        - "0.45mhz"
        - "0.4mhz"
      default: "3.21mhz"
      description: Sigma-Delta DCO Filter Selection, Bandwidth Fn (MHz)

    fdpll_lock_bypass_en:
      type: int
      enum:
        - 0
        - 1
      default: 0
      description: Lock Bypass

    fdpll_src:
      type: string
      enum:
        - "gclk0"
        - "gclk1"
        - "gclk2"
        - "gclk3"
        - "gclk4"
        - "gclk5"
        - "gclk6"
        - "gclk7"
        - "gclk8"
        - "gclk9"
        - "gclk10"
        - "gclk11"
        - "osc32k"
        - "xosc0"
        - "xosc1"
      default: "xosc0"
      description: Reference source clock selection

    fdpll_wakeup_fast_en:
      type: int
      enum:
        - 0
        - 1
      default: 0
      description: Wake Up Fast

    fdpll_pi_filter_type:
      type: string
      enum:
        - "92.7khz_0.76damp"
        - "131khz_1.08damp"
        - "46.4khz_0.38damp"
        - "65.6khz_0.54damp"
        - "131khz_0.56damp"
        - "185khz_0.79damp"
        - "65.6khz_0.28damp"
        - "92.7khz_0.39damp"
        - "46.4khz_1.49damp"
        - "65.6khz_2.11damp"
        - "23.2khz_0.75damp"
        - "32.8khz_1.06damp"
        - "65.6khz_1.07damp"
        - "92.7khz_1.51damp"
        - "32.8khz_0.53damp"
        - "46.4khz_0.75damp"
      default: "92.7khz_0.76damp"
      description: Proportional Integral Filter Selection
```

## dts/bindings/clock/microchip,sam-d5x-e5x-gclk.yaml
```yaml
# Copyright (c) 2025 Microchip Technology Inc.
# SPDX-License-Identifier: Apache-2.0

description: Microchip SAM D5x/E5x Generic Clock Controller (GCLK)

compatible: "microchip,sam-d5x-e5x-gclk"

include: [clock-controller.yaml, base.yaml]

clock-cells:
  - id

properties:
  reg:
    required: true

  "#clock-cells":
    const: 1

  in_frequency:
    type: array
    description: GCLK_IN 0-7 External clock
      frequency for GCLK Controller
    default:
      - 0
      - 0
      - 0
      - 0
      - 0
      - 0
      - 0
      - 0
```
