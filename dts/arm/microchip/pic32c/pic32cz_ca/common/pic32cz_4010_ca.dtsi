/*
 * Copyright (c) 2025 Microchip Technology Inc.
 *
 * SPDX-License-Identifier: Apache-2.0
 */

/*
 * Memory configuration: Flash size, RAM Size, Data Flash size
 * and additional nodes for 4010 memory variants
 */

/ {
	soc {
		flash0: flash@8000000 {
			reg = <0x08000000 DT_SIZE_M(4)>;
		};

		sram0: memory@20000000 {
			reg = <0x20000000 DT_SIZE_M(1)>;
		};
	};
};
