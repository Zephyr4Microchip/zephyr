/*
 * Copyright (c) 2025 Microchip Technology Inc.
 *
 * SPDX-License-Identifier: Apache-2.0
 */

/* Device-tree nodes specific to 100-pin package variants */

#include <microchip/pic32c/pic32cz_ca/common/pic32cz_ca.dtsi>
