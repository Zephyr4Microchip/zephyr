/*
 * Copyright (c) 2025 Microchip Technology Inc.
 *
 * SPDX-License-Identifier: Apache-2.0
 */

/* Memory configuration: Flash size, RAM Size and Data Flash size for 1051 memory variants */

/ {
	soc {
		flash0: flash@8000000 {
			reg = <0x08000000 DT_SIZE_M(1)>;
		};

		sram0: memory@20000000 {
			reg = <0x20000000 DT_SIZE_K(512)>;
		};
	};
};
