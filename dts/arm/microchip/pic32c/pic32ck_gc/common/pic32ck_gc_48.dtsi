/*
 * Copyright (c) 2025 Microchip Technology Inc.
 *
 * SPDX-License-Identifier: Apache-2.0
 */

/* Device-tree nodes specific to 48-pin package variants */

#include <microchip/pic32c/pic32ck_gc/common/pic32ck_gc.dtsi>
