/*
 * Copyright (c) 2025 Microchip Technology Inc.
 *
 * SPDX-License-Identifier: Apache-2.0
 */

/ {
	soc {
		tc4: tc@42001400 {
			compatible = "microchip,tc-g1";
			reg = <0x42001400 0x400>;
			instance-id = <PWM_COUNTER_MCHP_SAM_D5X_E5X_TC4_ID >;
			interrupts = <111 0>;
			clocks = <&mclkperiphperiph CLOCK_MCHP_MCLKPERIPH_ID_APBC_TC4>,
					<&gclkperiph CLOCK_MCHP_GCLKPERIPH_ID_TC4>;
			clock-names = "mclk", "gclk";

		};
		tc5: tc@42001800 {
			compatible = "microchip,tc-g1";
			reg = <0x42001800 0x400>;
			instance-id = <PWM_COUNTER_MCHP_SAM_D5X_E5X_TC5_ID>;
			interrupts = <112 0>;
			clocks = <&mclkperiphperiph CLOCK_MCHP_MCLKPERIPH_ID_APBC_TC5>,
					<&gclkperiph CLOCK_MCHP_GCLKPERIPH_ID_TC5>;
			clock-names = "mclk", "gclk";
		};
	};
};
