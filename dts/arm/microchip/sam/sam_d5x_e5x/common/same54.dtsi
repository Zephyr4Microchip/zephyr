/*
 * Copyright (c) 2026 Microchip Technology Inc.
 *
 * SPDX-License-Identifier: Apache-2.0
 */

/ {
	soc {
		gmac: ethernet@42000800 {
			compatible = "microchip,gmac-g1-eth";
			reg = <0x42000800 0x400>;
			interrupts = <84 0>;
			interrupt-names = "gmac";
			num-queues = <1>;
			local-mac-address = [00 00 00 00 00 00];
			clocks = <&mclkperiph CLOCK_MCHP_MCLKPERIPH_ID_AHB_GMAC>,
				 <&mclkperiph CLOCK_MCHP_MCLKPERIPH_ID_APBC_GMAC>;
			clock-names = "mclk-ahb", "mclk-apb";
			status = "disabled";
		};
	};
};
