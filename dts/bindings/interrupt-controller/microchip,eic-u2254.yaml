## samples/bluetooth/peripheral/boards/wbz450_curiosity.conf
```kconfig
#
# Copyright (c) 2025 Microchip Technology Inc.
#
# SPDX-License-Identifier: Apache-2.0
#

CONFIG_SYSTEM_WORKQUEUE_STACK_SIZE=4096

CONFIG_MAIN_STACK_SIZE=3072
CONFIG_BT_RX_STACK_SIZE=3072
CONFIG_BT_HCI_ACL_FLOW_CONTROL=n

CONFIG_BT_BUF_ACL_RX_SIZE=251
CONFIG_BT_L2CAP_TX_MTU=247
```

## samples/bluetooth/peripheral_hids/boards/pic32wm_bz6204_curiosity.conf
```kconfig
#
# Copyright (c) 2025 Microchip Technology Inc.
#
# SPDX-License-Identifier: Apache-2.0
#

CONFIG_BT_MAX_PAIRED=8

CONFIG_BT_RX_STACK_SIZE=3072
CONFIG_BT_HCI_ACL_FLOW_CONTROL=n
```

## samples/net/openthread/coap/sample.yaml
```yaml
common:
  harness: net
  tags:
    - net
    - openthread
  depends_on: openthread
  min_flash: 140
sample:
  description: Runs the OpenThread stack as FTD with CoAP
  name: OpenThread FTD CoAP
tests:
  sample.net.openthread.ftd.coap.client:
    build_only: true
    platform_allow:
      - cc1352p7_lp
      - wbz450_curiosity
      - wbz451_curiosity
      - wbz451hpe_curosity
      - pic32wm_bz6204_curiosity
  sample.net.openthread.ftd.coap.server:
    build_only: true
    platform_allow:
      - cc1352p7_lp
      - wbz450_curiosity
      - wbz451_curiosity
      - wbz451hpe_curosity
      - pic32wm_bz6204_curiosity
    extra_configs:
      - CONFIG_OT_COAP_SAMPLE_SERVER=y
```

## samples/net/openthread/coprocessor/boards/wbz45x_curiosity.conf
```kconfig
#
# Copyright (c) 2025 Microchip Technology Inc.
#
# SPDX-License-Identifier: Apache-2.0
#
#Enable HW Encryption for Enh ACKs
CONFIG_IEEE802154_PIC32CX_BZ_CRYPTO=y
CONFIG_LOG_BACKEND_RTT=n
```

## samples/net/openthread/shell/boards/pic32wm_bz6204_curiosity.conf
```kconfig
#
# Copyright (c) 2025 Microchip Technology Inc.
#
# SPDX-License-Identifier: Apache-2.0
#
#Enable Test Random Generator
CONFIG_TEST_RANDOM_GENERATOR=y
```

## soc/microchip/pic32c/pic32ck_gc/Kconfig
```kconfig
# Copyright (c) 2026 Microchip Technology Inc.
# SPDX-License-Identifier: Apache-2.0

config SOC_FAMILY_MICROCHIP_PIC32CK_GC
	select ARM
	select MICROCHIP_PIC32C
	select CPU_CORTEX_M33
	select CPU_CORTEX_M_HAS_SYSTICK
	select CPU_CORTEX_M_HAS_VTOR
	select CPU_HAS_ARM_MPU
	select ARMV8_M_DSP
	select CPU_HAS_FPU
	select CPU_CORTEX_M_HAS_DWT
	select CPU_HAS_ICACHE
	select CPU_HAS_DCACHE
	select INIT_ARCH_HW_AT_BOOT
	select XIP
```
