## dts/bindings/interrupt-controller/microchip,eic-u2254.yaml
```yaml
# Copyright (c) 2025 Microchip Technology Inc.
# SPDX-License-Identifier: Apache-2.0

description: Microchip External Interrupt Controller
compatible: "microchip,eic-u2254"

include: base.yaml

properties:
  reg:
    required: true
    description: Specifies the base address and size of the register
      block for the watchdog timer.

  interrupts:
    required: true
    description: Specifies the interrupt line in the NVIC

  low-power-mode:
    type: boolean
    description: Enables low power mode for eic peripheral
```

## dts/bindings/mspi/microchip,qspi-g1-mspi.yaml
```yaml
# Copyright (c) 2025 Microchip Technology Inc.
# SPDX-License-Identifier: Apache-2.0
title: Microchip MSPI G1 QSPI driver

description: |
    Microchip MSPI driver bindings.

    Group g1 MSPI driver supports following hardware peripherals:
    - name="QSPI" id="U2008" version="1.6.3"

compatible: "microchip,qspi-g1-mspi"

include:
  - base.yaml
  - pinctrl-device.yaml
  - mspi-controller.yaml

properties:
  reg:
    type: array
    required: true

  interrupts:
    type: array
    required: true

  clocks:
    type: phandle-array
    required: true
    description: APB, AHB, and AHB2X in that order.

  clock-names:
    type: string-array
    required: true
    enum: ["apb", "ahb", "ahb2x"]

  software-multiperipheral:
    type: boolean
    description: Use software-controlled chip selects for multiple peripherals.
```

## dts/bindings/mtd/microchip,n25q256a-flash.yaml
```yaml
# Copyright (c) 2025 Microchip Technology Inc.
# SPDX-License-Identifier: Apache-2.0
title: Microchip MSPI/QSPI child flash (vendor extensions)

description: |
  Vendor-specific properties for flashes attached to the Microchip MSPI/QSPI
  controller. This augments the standard "jedec,spi-nor" binding.

compatible: "micron,n25q256a-flash"

include: ["jedec,mspi-nor.yaml"]

properties:
  reg:             # CE index
    description: |
      Chip-select index for the flash device (0-based).
    required: true

  mspi-max-frequency:
    description: Maximum supported SPI clock frequency in Hz.

  mspi-io-mode:
    type: string
    description: Bus IO width used in instruction mode (1-1-1, 1-1-2, 1-1-4).

  mspi-data-rate:
    type: string
    description: Transfer rate mode for instruction/data phases.

  mspi-cpp-mode:
    type: string
    description: Controller-specific command polarity and phase protocol mode.

  mspi-ce-polarity:
    type: string
    description: Chip-select polarity as driven by the controller.

  rx-dummy:
    type: int
    description: Number of dummy cycles for read transactions.

  tx-dummy:
    type: int
    description: Number of dummy cycles for program transactions (usually 0).

  read-command:
    type: int
    description: Read opcode to use for instruction-mode access.

  write-command:
    type: int
    description: Program opcode to use for page program.

  command-length:
    type: string
    description: Width of the instruction phase in bytes.

  address-length:
    type: string
    description: Address length used by controller for instruction-mode ops.

  ce-break-config:
    type: array
    description: Controller-specific CE break config <memory_boundary time_to_break>.
```

## dts/bindings/pwm/microchip,pwm-tc-u2249.yaml
```yaml
# Copyright (c) 2025 Microchip Technology Inc.
# SPDX-License-Identifier: Apache-2.0

# Description of the Microchip PWM TC driver
description: >
  Microchip PWM TC  driver. This driver is responsible for configuring
  and managing the TC peripheral in Microchip microcontrollers for PWM configuration.

# Compatible string to match this device with the corresponding driver
compatible: "microchip,pwm-tc-u2249"

# Include base properties from the common TC binding file
include:
  - pwm-controller.yaml
  - microchip,tc-u2249.yaml

properties:
  channels:
    type: int
    required: true
    description: >
      This specifies the maximum number of channels available for the peripheral.

  max_bit_width:
    type: int
    required: true
    description: >
      Maximum bit width supported by the PWM counter. This property indicates the
      resolution of the counter, which can be 8, 16, 24, or 32 bits.
    enum:
      - 8
      - 16
      - 32

  "#pwm-cells":
    const: 3
# Example usage in a Device Tree Source (DTS) file:
#
#   pwm_led0: pwm_led_0 {
#       status = "okay";
#       pwms = <&tcc0 2 PWM_MSEC(20) 0>;
#   };
#
# Explanation:
#   - 'pwm_led0' is a node representing a device (e.g., an LED) controlled by PWM.
#   - The 'pwms' property uses the phandle to the PWM controller (here, 'tcc0'),
#     specifies channel 2, sets the PWM period to 20 milliseconds,
#     and uses a polarity of 0 (normal).
#   - The order of the 'pwms' arguments matches the 'pwm-cells' definition:
#       <&controller channel period polarity>
#   - This allows the device to be driven with a specific PWM configuration using
#     the Microchip PWM TC driver.
pwm-cells:
  - channel
  - period
  - polarity
```

## dts/bindings/pwm/microchip,pwm-tcc-u2213.yaml
```yaml
# Copyright (c) 2025 Microchip Technology Inc.
# SPDX-License-Identifier: Apache-2.0

# Description of the Microchip TC, RTC, and TCC counter driver
description: >
  Microchip TCC pwm driver. This driver is used for configuring
  and managing TCC (Timer/ Counter for Control Applications)
  peripheral in Microchip microcontrollers. This peripherals
  support creating PWM signals.

# Compatible strings for the device
compatible: "microchip,pwm-tcc-u2213"

# Include base properties from the common TCC binding file

include:
  - base.yaml
  - pwm-controller.yaml
  - microchip,tcc-u2213.yaml
  - pinctrl-device.yaml

pwm-cells:
  - channel
  - period
  - polarity

properties:
  # Maximum bit width supported by the counter
  max_bit_width:
    type: int
    required: true
    description: >
      Maximum bit width supported by the counter. This property indicates the
      resolution of the counter, which can be 8, 16, 24, or 32 bits.
    enum:
      - 16
      - 24

  channels:
    type: int
    required: true
    description: >
      This property indicates the maximum available channels in a peripheral instance
```

## dts/bindings/pwm/microchip,tcc-g1-pwm.yaml
```yaml
# Copyright (c) 2025 Microchip Technology Inc.
# SPDX-License-Identifier: Apache-2.0

# Description of the Microchip TCC PWM driver
description: |
  Microchip TCC pwm driver.

  This driver is used for configuring
  and managing TCC (Timer/ Counter for Control Applications)
  peripheral in Microchip microcontrollers. This peripherals
  support creating PWM signals. The supported peripherals are
  as follows:
    - tcc-u2213

compatible: "microchip,tcc-g1-pwm"

include:
  - base.yaml
  - pwm-controller.yaml
  - microchip,tcc-g1.yaml
  - pinctrl-device.yaml

properties:
  wexctrl_dths:
    type: int
    default: 128
    description: |
     Dead-Time High Side Outputs Value. 
     The value must not be more than 8bit.

  wexctrl_dtls:
    type: int
    default: 128
    description: |
     Dead-Time Low Side Outputs Value
     The value must not be more than 8bit.

  wexctrl_otmx:
    type: int
    default: 0
    enum:
      - 0
      - 1
      - 2
      - 3
    description: |
     Output Matrix

  "#pwm-cells":
    const: 3

pwm-cells:
  - channel
  - period
  - polarity
```

## dts/bindings/reset/microchip,rcon-g1-reset.yaml
```yaml
# Copyright (c) 2025 Microchip Technology Inc.
# SPDX-License-Identifier: Apache-2.0

description: Microchip RCON G1 Reset Controller

include: base.yaml

compatible: "microchip,rcon-g1-reset"

properties:
  reg:
    required: true
    description: Base address and size of the RCON register block.
```

## dts/bindings/reset/microchip,rstc-g1.yaml
```yaml
# Copyright (c) 2025 Microchip Technology Inc.
# SPDX-License-Identifier: Apache-2.0

description: Microchip RSTC g1 Reset Controller

include: base.yaml

compatible: "microchip,rstc-g1"

properties:
  reg:
    required: true
    description: Base address and size of the RSTC register block.
```

## dts/bindings/reset/microchip,rstc-u2239.yaml
```yaml
# Copyright (c) 2025 Microchip Technology Inc.
# SPDX-License-Identifier: Apache-2.0

description: Microchip RSTC U2239 Reset Controller

include: base.yaml

compatible: "microchip,rstc-u2239"

properties:
  reg:
    required: true
    description: Base address and size of the RSTC register block.
```

## dts/bindings/rng/microchip,trng-g1-entropy.yaml
```yaml
# Copyright (c) 2025, Microchip Technologies Inc.
# SPDX-License-Identifier: Apache-2.0

description: |
  Microchip TRNG driver bindings.

  Group g1 TRNG driver supports following hardware peripherals:
    - module name="TRNG" id="U2242" version="1.1.0"

compatible: "microchip,trng-g1-entropy"

include: base.yaml

properties:
  reg:
    required: true

  interrupts:
    required: true
```

## dts/bindings/rng/microchip,trng-u2242.yaml
```yaml
# Copyright (c) 2025, Microchip Technologies Inc.
# SPDX-License-Identifier: Apache-2.0

description: MICROCHIP TRNG U2242

compatible: "microchip,trng-u2242"

include: base.yaml

properties:
  reg:
    required: true

  interrupts:
    required: true
```

## dts/bindings/rtc/microchip,rtc-u2250.yaml
```yaml
# Copyright(c) 2025 Microchip Technology Inc.
# SPDX-License-Identifier: Apache-2.0

description: Microchip RTC peripheral binding. This driver configures
  the RTC peripheral in Microchip microcontrollers for clock and interrupts.

compatible: "microchip,rtc-u2250"

include:
  - name: rtc.yaml
  - name: pinctrl-device.yaml

properties:
  reg:
    required: true
    description: Register base address and size for the RTC peripheral.

  clocks:
    required: true
    description: Clock phandles used to drive the RTC.

  clock-names:
    required: true
    description: Clock name corresponding to the `clocks` entry.

  interrupts:
    required: true
    description: Interrupt specifier for the RTC peripheral.

  prescaler:
    type: int
    enum:
      - 1
      - 2
      - 4
      - 8
      - 16
      - 32
      - 64
      - 128
      - 256
      - 512
      - 1024
    description: |
      RTC frequency equals clock-frequency divided by the prescaler value

  alarms-count:
    type: int
    default: 0
    description: |
      Number of alarms supported by RTC device. The number of
      alarms defaults to 0, which indicates that the RTC has
      no alarms.

  cal-constant:
    type: int
    description: |
      Define the constant used to calculate the calibration. More
      information can be found in the datasheet of each SoC series
      at RTC Frequency Correction topic.

# Example:
# Correction in ppm = (FREQCORR.VALUE * 1e6 ppm) / (8192 * 128)
#
# &rtc {
#     cal-constant = <1048576>; /* 8192 * 128 */
# };
```

## dts/bindings/serial/microchip,sercom-g1-uart.yaml
```yaml
# Copyright (c) 2025 Microchip Technology Inc.
# SPDX-License-Identifier: Apache-2.0

description: |
  Microchip sercom-g1 uart driver bindings.

  sercom-g1 uart is used in the below families:
    - SAM D5x/E5x

compatible: "microchip,sercom-g1-uart"

include:
  - name: uart-controller.yaml
  - name: pinctrl-device.yaml

properties:
  reg:
    required: true

  interrupts:
    required: true

  clocks:
    required: true

  clock-names:
    required: true

  rxpo:
    type: int
    required: true
    description: |
      Define the receive data (RxD) pin configuration.
      An enumeration with the following values:

      +-------+---------------+
      | Value | RX Pin        |
      +-------+---------------+
      |     0 | SERCOM_PAD[0] |
      +-------+---------------+
      |     1 | SERCOM_PAD[1] |
      +-------+---------------+
      |     2 | SERCOM_PAD[2] |
      +-------+---------------+
      |     3 | SERCOM_PAD[3] |
      +-------+---------------+


  txpo:
    type: int
    required: true
    description: |
      Transmit Data Pinout. An enumeration with values that depend on the
      hardware being used. This controls both the transmit pins and if
      hardware flow control is used.

      SAMD5/E5:

      +-------+---------------+---------------+---------------+
      | Value | TX Pin        | RTS           | CTS           |
      +-------+---------------+---------------+---------------+
      |     0 | SERCOM_PAD[0] |           N/A |           N/A |
      +-------+---------------+---------------+---------------+
      |     1 | Reserved                                      |
      +-------+---------------+---------------+---------------+
      |     2 | SERCOM_PAD[0] | SERCOM_PAD[2] | SERCOM_PAD[3] |
      +-------+---------------+---------------+---------------+
      |     3 | SERCOM_PAD[0] | SERCOM_PAD[2] |           N/A |
      +-------+---------------+---------------+---------------+

  clock-external:
    type: boolean
    description: select external clock for uart (external clock if true).

  collision-detection:
    type: boolean
    description: Enable collision detection for half-duplex mode.
```

## dts/bindings/watchdog/microchip,wdt-u2251.yaml
```yaml
# Copyright (c) 2025, Microchip Technologies Inc.
# SPDX-License-Identifier: Apache-2.0

description: MICROCHIP Watchdog U2251

compatible: "microchip,wdt-u2251"

include: base.yaml

properties:
  reg:
    required: true
    description: Specifies the base address and size of the register
      block for the watchdog timer.

  clocks:
    required: true
    description: Defines the clock sources used by the watchdog timer peripheral.

  clock-names:
    required: true
    description: Names of the clocks referenced in the "clocks"
      property, used to identify the clock sources

  max_installable_timeout_count:
    type: int
    required: true
    description: Specifies the maximum number of timeout
      counts that can be configured for the watchdog timer.

  max_timeout_window:
    type: int
    required: true
    description: Defines the maximum timeout window period for the watchdog timer

  max_timeout_window_mode:
    type: int
    required: true
    description: Indicates the maximum timeout period in window mode
      for the watchdog timer.

  min_window_limit:
    type: int
    required: true
    description: Indicates the minimum window limit for the watchdog
      timer in window mode
```

## modules/Kconfig.microchip
```kconfig
# Copyright (c) [2019- 2025] [Microchip Technology Inc.]
# SPDX-License-Identifier: Apache-2.0

config HAS_MEC_HAL
	bool "Microchip MEC HAL drivers support"

config HAS_MPFS_HAL
	bool "Microchip MPFS HAL drivers support"

config HAS_MEC5_HAL
	bool "Microchip MEC5 HAL drivers support"

config HAS_MCHP_HAL_DFP
	bool "Microchip HAL Device Family Pack support"

config HAS_MCHP_HAL_INCLUDE
	bool "Microchip HAL include files support"

config HAS_MCHP_HAL_PERIPHERALS
	bool "Microchip HAL peripheral drivers support"
```

## samples/bluetooth/central_multilink/boards/wbz451_curiosity.conf
```kconfig
#
# Copyright (c) 2025 Microchip Technology Inc.
#
# SPDX-License-Identifier: Apache-2.0
#

CONFIG_BT_MAX_CONN=8

CONFIG_BT_RX_STACK_SIZE=2048
CONFIG_SYSTEM_WORKQUEUE_STACK_SIZE=2048
CONFIG_BT_HCI_ACL_FLOW_CONTROL=n
```

## samples/bluetooth/hci_uart/boards/wbz450_curiosity.conf
```kconfig
#
# Copyright (c) 2025 Microchip Technology Inc.
#
# SPDX-License-Identifier: Apache-2.0
#

CONFIG_BT_BUF_ACL_TX_SIZE=256
CONFIG_BT_BUF_ACL_TX_COUNT=10
```

## samples/bluetooth/mesh_demo/boards/wbz451_curiosity.conf
```kconfig
#
# Copyright (c) 2025 Microchip Technology Inc.
#
# SPDX-License-Identifier: Apache-2.0
#

CONFIG_MAIN_STACK_SIZE=2048

# Number of key slots in PSA Crypto
CONFIG_MBEDTLS_PSA_KEY_SLOT_COUNT=7
```

## samples/bluetooth/mesh_provisioner/boards/wbz451_curiosity.conf
```kconfig
#
# Copyright (c) 2025 Microchip Technology Inc.
#
# SPDX-License-Identifier: Apache-2.0
#
CONFIG_GPIO=y
CONFIG_SYSTEM_WORKQUEUE_STACK_SIZE=4096
CONFIG_BT_MESH_ADV_STACK_SIZE=2048
```
