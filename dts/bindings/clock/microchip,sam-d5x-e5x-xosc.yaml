## dts/bindings/gpio/microchip,port-u2210-gpio.yaml
```yaml
# Copyright (c) 2025 Microchip Technology Inc.
# SPDX-License-Identifier: Apache-2.0

description: Microchip PORT-u2210 (GPIO)

compatible: "microchip,port-u2210-gpio"

include: [gpio-controller.yaml, base.yaml]

properties:
  reg:
    required: true

  "#gpio-cells":
    const: 2

  "#microchip,pin-cells":
    type: int
    required: true
    const: 2
    description: Number of items to expect in a microchip,pins specifier

gpio-cells:
  - pin
  - flags

microchip,pin-cells:
  - pin
  - peripheral
```

## dts/bindings/gpio/microchip,same54-gpio.yaml
```yaml
description: SAME54 GPIO PORT node

compatible: "microchip,same54-gpio"

include: [gpio-controller.yaml, base.yaml]

properties:
  reg:
    required: true

  "#gpio-cells":
    const: 2

  "#microchip,pin-cells":
    type: int
    required: true
    const: 2
    description: Number of items to expect in a microchip,pins specifier

gpio-cells:
  - pin
  - flags

microchip,pin-cells:
  - pin
  - peripheral
```

## dts/bindings/hwinfo/microchip,hwinfo-g1.yaml
```yaml
# Copyright (c) 2025 Microchip Technology Inc.
# SPDX-License-Identifier: Apache-2.0

description: Microchip Hardware information driver bindings.

compatible: "microchip,hwinfo-g1"

include: base.yaml

properties:
  reg:
    required: true
```

## dts/bindings/i2c/microchip,sercom-u2201-i2c.yaml
```yaml
# Copyright (c) 2025 Microchip Technology Inc.
# SPDX-License-Identifier: Apache-2.0

description: MCHP SERCOM-U2201 I2C node

compatible: "microchip,sercom-u2201-i2c"

include:
  - name: i2c-controller.yaml
  - name: pinctrl-device.yaml

properties:
  reg:
    required: true

  interrupts:
    required: true

  clocks:
    required: true

  clock-names:
    required: true

  dmas:
    description: |
      Optional TX & RX dma specifiers.  Each specifier will have a phandle
      reference to the dmac controller, the channel number, and peripheral
      trigger source.

      For example dmas for TX, RX on SERCOM3
         dmas = <&dmac 0 0xb>, <&dmac 0 0xa>;

  dma-names:
    description: |
      Required if the dmas property exists.  This should be "tx" and "rx"
      to match the dmas property.

      For example
         dma-names = "tx", "rx";
```

## dts/bindings/ieee802154/microchip,pic32cx-bz-ieee802154.yaml
```yaml
# Copyright (c) 2022 Nordic Semiconductor ASA
# SPDX-License-Identifier: Apache-2.0

description: Microchip PIC32CX_BZ IEEE 802.15.4 node

compatible: "microchip,pic32cx-bz-ieee802154"

include: base.yaml
```
