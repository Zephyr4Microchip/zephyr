## dts/bindings/clock/microchip,sam-d5x-e5x-xosc.yaml
```yaml
# Copyright (c) 2025 Microchip Technology Inc.
# SPDX-License-Identifier: Apache-2.0

include: [base.yaml]

description: Crystal Oscillators (XOSCn) configuration.
compatible: "microchip,sam-d5x-e5x-xosc"

child-binding:
  properties:
    subsystem:
      type: int
      required: true
      description: Clock subsystem

    xosc_frequency:
      type: int
      default: 12000000
      description: Crystal/External clock frequency for XOSC Controller

    xosc_startup_time:
      type: int
      enum:
        - 1
        - 2
        - 4
        - 8
        - 16
        - 32
        - 64
        - 128
        - 256
        - 512
        - 1024
        - 2048
        - 4096
        - 8192
        - 16384
        - 32768
      default: 1
      description: XOSC start-up time. Select number of OSCULP32K oscillator clock cycles.

    xosc_clock_switch_en:
      type: int
      enum:
        - 0
        - 1
      default: 0
      description: Switch back to the external clock or crystal oscillator for clock recovery

    xosc_clock_failure_detection_en:
      type: int
      enum:
        - 0
        - 1
      default: 0
      description: Clock Failure Detector Enable

    xosc_automatic_loop_control_en:
      type: int
      enum:
        - 0
        - 1
      default: 0
      description: Oscillator's amplitude automatically adjusted

    xosc_low_buffer_gain_en:
      type: int
      enum:
        - 0
        - 1
      default: 0
      description: |
        Increase the oscillator's amplitude by a factor of approximately 2.
        Use this setting to solve stability issues.

    xosc_on_demand_en:
      type: int
      enum:
        - 0
        - 1
      default: 0
      description: |
        0: The oscillator is always ON normally.
        In standby sleep mode, oscillator will be OFF if there is no peripheral request,
        unless run_in_standby_en is 1.
        1: In both normal and standby sleep mode, The oscillator is ON,
        when a peripheral is requesting the oscillator to be used as a clock source.
        The oscillator is OFF if no peripheral is requesting the clock source.
        Important: Initializing it with 1, along with clock enabled, can lead to indefinite wait
        for the clock to be on, if there is no peripheral request for the clock in the sequence of
        clock Initialization. If required, better to turn on the clock using API, instead of
        enabling both during startup.

    xosc_run_in_standby_en:
      type: int
      enum:
        - 0
        - 1
      default: 0
      description: |
        0: The XOSCn is OFF in standby sleep mode if no peripheral requests the clock.
        1: The XOSCn is always ON in standby sleep mode, unless on_demand_en is 1.
        If on_demand_en is 1, the XOSCn will be ON only when a peripheral is requesting
        the clock, even if run_in_standby_en is 1.

    xosc_xtal_en:
      type: int
      enum:
        - 0
        - 1
      default: 0
      description: |
        Selects external clock or crystal oscillator
        0 - External clock connected on XIN. XOUT can be used as general-purpose I/O.
        1 - Crystal connected to XIN/XOUT.

    xosc_en:
      type: int
      enum:
        - 0
        - 1
      default: 0
      description: Oscillator Enable
```

## dts/bindings/clock/microchip,same54-clock.yaml
```yaml
#
# Copyright (c) [2025] [Microchip Technology Inc.]
#
# SPDX-License-Identifier: Apache-2.0
#

description: Microchip SAME54 Clock System (OSCCTRL, OSC32KCTRL, MCLK, GCLK)

compatible: "microchip,same54-clock"

include: [clock-controller.yaml, base.yaml]

clock-cells:
  - id

properties:

  "#clock-cells":
    const: 1
```

## dts/bindings/clock/microchip,same54-gclk.yaml
```yaml
#
# Copyright (c) [2025] [Microchip Technology Inc.]
#
# SPDX-License-Identifier: Apache-2.0
#

description: Microchip SAME54 Generic Clock Controller (GCLK)

compatible: "microchip,same54-gclk"

include: [clock-controller.yaml, base.yaml]

clock-cells:
  - id

properties:
  reg:
    required: true

  "#clock-cells":
    const: 1

  in_frequency:
    type: array
    description: GCLK_IN 0-7 External clock
      frequency for GCLK Controller
    default:
      - 0
      - 0
      - 0
      - 0
      - 0
      - 0
      - 0
      - 0
```

## dts/bindings/clock/microchip,same54-mclk.yaml
```yaml
# Copyright (c) 2025 Microchip Technology Inc.
# SPDX-License-Identifier: Apache-2.0

description: Microchip SAME54 Generic Clock Controller (MCLK)

compatible: "microchip,same54-mclk"

include: [clock-controller.yaml, base.yaml]

clock-cells:
  - id

properties:
  reg:
    required: true

  "#clock-cells":
    const: 1
```

## dts/bindings/clock/microchip,same54-osc32kctrl.yaml
```yaml
# Copyright (c) 2025 Microchip Technology Inc.
# SPDX-License-Identifier: Apache-2.0

description: Microchip SAME54 OSC32KCTRL Clock Controller (OSC32KCTRL)

compatible: "microchip,same54-osc32kctrl"

include: [clock-controller.yaml, base.yaml]

clock-cells:
  - id

properties:
  reg:
    required: true

  "#clock-cells":
    const: 1

  xosc32k_frequency:
    type: int
    description: Crystal/External clock
      frequency for XOSC32K Controller
    default: 32768
```

## dts/bindings/clock/microchip,same54-oscctrl.yaml
```yaml
#
# Copyright (c) [2025] [Microchip Technology Inc.]
#
# SPDX-License-Identifier: Apache-2.0
#

description: Microchip SAME54 OSCCTRL Clock Controller (OSCCTRL)

compatible: "microchip,same54-oscctrl"

include: [clock-controller.yaml, base.yaml]

clock-cells:
  - id

properties:
  reg:
    required: true

  "#clock-cells":
    const: 1

  dfll_frequency:
    type: int
    description: Output Clock frequency of DPLL Controller
    default: 48000000

  xosc_frequency:
    type: int
    description: Crystal/External clock frequency for
      XOSC Controller
    default: 24000000
```

## dts/bindings/clock/microchip/pic32ck_sg_gc/microchip,pic32ck-sg-gc-rtc.yaml
```yaml
# Copyright (c) 2026 Microchip Technology Inc.
# SPDX-License-Identifier: Apache-2.0

title: PIC32CK_SG_GC RTC clock

description: |
  RTC clock configuration.

include: [base.yaml]

compatible: "microchip,pic32ck-sg-gc-rtc"

properties:
  "#clock-cells":
    type: int
    const: 1
    description: |
      clock subsystem

  rtc-src:
    type: int
    default: 0
    description: |
      RTC source clock selection
      0: ulp1k
      1: ulp32k
      4: xosc1k
      5: xosc32k

clock-cells:
  - subsystem
```

## dts/bindings/clock/microchip_sam_d5x_e5x/microchip,sam-d5x-e5x-rtc.yaml
```yaml
# Copyright (c) 2025 Microchip Technology Inc.
# SPDX-License-Identifier: Apache-2.0

include: [base.yaml]

description: |
  RTC clock configuration.

compatible: "microchip,sam-d5x-e5x-rtc"

properties:
  "#clock-cells":
    const: 1
    type: int

  rtc-src:
    type: int
    default: 0
    description: |
      RTC source clock selection
      0: ulp1k
      1: ulp32k
      4: osc1k
      5: xosc32k

clock-cells:
  - subsystem
```

## dts/bindings/counter/microchip,counter-rtc-u2250.yaml
```yaml
# Copyright (c) 2025 Microchip Technology Inc.
# SPDX-License-Identifier: Apache-2.0

description: |
  Microchip RTC counter driver. This driver is used for configuring and
  managing the RTC (Real Time Counter) peripheral in Microchip microcontrollers.
  These peripherals support measuring time intervals and generating periodic
  interrupts.
compatible: "microchip,counter-rtc-u2250"

include: microchip,rtc-u2250.yaml
properties:
  max-bit-width:
    type: int
    required: true
    description: |
      Maximum bit width supported by the counter. This property indicates the
      resolution of the counter, which can be 16 or 32 bits.
    enum:
      - 16
      - 32
```

## dts/bindings/counter/microchip,counter-tc-u2249.yaml
```yaml
# Copyright (c) 2025 Microchip Technology Inc.
# SPDX-License-Identifier: Apache-2.0

description: |
  Microchip TC (Timer Counter) driver. This driver is responsible for configuring
  and managing the TC peripheral in Microchip microcontrollers. The TC module
  supports event counting, time interval measurement, and periodic interrupt
  generation.

compatible: "microchip,counter-tc-u2249"

include: microchip,tc-u2249.yaml

properties:
  max-bit-width:
    type: int
    required: true
    description: |
      Maximum bit width supported by the counter. This property indicates the
      resolution of the counter, which can be 8, 16, 24, or 32 bits.
    enum:
      - 8
      - 16
      - 32
```

## dts/bindings/counter/microchip,counter-tcc-u2213.yaml
```yaml
# Copyright (c) 2025 Microchip Technology Inc.
# SPDX-License-Identifier: Apache-2.0

description: |
  Microchip TCC counter driver. This driver is used for configuring and anaging TCC
  (Timer Counter Control) peripheral in Microchip microcontrollers. This peripherals
  support counting events, measuring time intervals, and generating periodic interrupts.

compatible: "microchip,counter-tcc-u2213"

include: microchip,tcc-u2213.yaml
properties:
  max-bit-width:
    type: int
    required: true
    description: |
      Maximum bit width supported by the counter. This property indicates the
      resolution of the counter, which can be 8, 16, 24, or 32 bits.
    enum:
      - 16
      - 24
```

## dts/bindings/counter/microchip,rtc-g1-counter.yaml
```yaml
# Copyright (c) 2025 Microchip Technology Inc.
# SPDX-License-Identifier: Apache-2.0

description: |
  Microchip RTC counter driver.

  This driver is used for configuring and  managing the RTC (Real Time Counter)
  peripheral in Microchip microcontrollers.
  These peripherals support measuring time intervals and generating periodic
  interrupts.
  The supported devices are :
    - rtc-u2250

compatible: "microchip,rtc-g1-counter"
include: microchip,rtc-g1.yaml
properties:
  max-bit-width:
    type: int
    required: true
    description: |
      Maximum bit width supported by the counter.

      This property indicates the resolution of the counter.
    enum:
      - 16
      - 32
```

## dts/bindings/counter/microchip,tc-g1-counter.yaml
```yaml
# Copyright (c) 2025 Microchip Technology Inc.
# SPDX-License-Identifier: Apache-2.0

description: |
  Microchip TC (Timer Counter) driver.

  This driver is responsible for configuring
  and managing the TC peripheral in Microchip microcontrollers. The TC module
  supports event counting, time interval measurement, and periodic interrupt
  generation.
  The supported devices :
    - tc-u2249

compatible: "microchip,tc-g1-counter"

include: microchip,tc-g1.yaml
```

## dts/bindings/counter/microchip,tcc-g1-counter.yaml
```yaml
# Copyright (c) 2025 Microchip Technology Inc.
# SPDX-License-Identifier: Apache-2.0

description: |
  Microchip TCC counter driver.

  This driver is used for configuring and anaging TCC
  (Timer Counter Control) peripheral in Microchip microcontrollers. This peripherals
  support counting events, measuring time intervals, and generating periodic interrupts.
  The supported devices :
    - tcc-u2213

compatible: "microchip,tcc-g1-counter"

include: microchip,tcc-g1.yaml
```

## dts/bindings/dac/microchip,dac-u2502.yaml
```yaml
# Copyright (c) 2025 Microchip Technology Inc.
# SPDX-License-Identifier: Apache-2.0

description: Microchip DAC controller

compatible: "microchip,dac-u2502"

include:
  - name: dac-controller.yaml
  - name: pinctrl-device.yaml

properties:
  reg:
    required: true

  clocks:
    required: true

  clock-names:
    required: true

  "#io-channel-cells":
    type: int
    required: true
    const: 1
    description: Number of cells needed to represent a channel.

  refsel:
    type: string
    required: true
    description: |
      Reference Voltage selection. Must be one of:
      - "vrefau" (0x0) - Unbuffered External Voltage Reference
      - "vddana" (0x1) - Voltage Supply
      - "vrefab" (0x2) - Buffered External Voltage Reference
      - "intref" (0x3) - Internal Bandgap Reference
    enum:
      - "vrefau"
      - "vddana"
      - "vrefab"
      - "intref"

  max_channels:
    type: int
    default: 2
    description: |
      Maximum number of channels

child-binding:
  description: |
    Channel configuration.
    All nodes using this binding must be named "channel".

  properties:
    channel:
      type: int
      required: true
      description: Channel identifier.

    rate:
      type: int
      required: true
      description: |
        Conversion Speed in kSPS(Kilo Samples per second)
      enum:
        - 100
        - 500
        - 1000

    ext_filter:
      type: boolean
      description: |
        Enable External Filter

    data_adj:
      type: string
      default: right
      description: |
        Adjust Data in Data Register
      enum:
        - right
        - left

    dither:
      type: boolean
      description: |
        Enable the Dithering Mode

    sampling_ratio:
      type: int
      default: 1
      description: |
        Set the Oversampling Ratio
        Setting the Oversampling Ratio will Disable the refresh rate.
      enum:
        - 1
        - 2
        - 4
        - 8
        - 16
        - 32

    refresh:
      type: int
      default: 0
      description: |
        Refresh Period in us ( 0 - Disabled )
      enum:
        - 0
        - 30
        - 60
        - 90
        - 120
        - 150
        - 180
        - 210
        - 240
        - 270
        - 300
        - 330
        - 360
        - 390
        - 420
        - 450
```

## dts/bindings/flash_controller/microchip,nvmctrl-g1.yaml
```yaml
# Copyright (c) 2025 Microchip Technology Inc.
# SPDX-License-Identifier: Apache-2.0

description: Microchip Non-Volatile Memory Controller for g1 ips

compatible: "microchip,nvmctrl-g1"

include: flash-controller.yaml
```

## dts/bindings/flash_controller/microchip,nvmctrl-g2-flash.yaml
```yaml
# Copyright (c) 2025 Microchip Technology Inc.
# SPDX-License-Identifier: Apache-2.0

description: Microchip Non-Volatile Memory Controller G2

compatible: "microchip,nvmctrl-g2-flash"

include: flash-controller.yaml
```

## dts/bindings/flash_controller/microchip,nvmctrl-u2409.yaml
```yaml
# Copyright (c) 2025 Microchip Technology Inc.
# SPDX-License-Identifier: Apache-2.0

description: Microchip Non-Volatile Memory Controller u2409

compatible: "microchip,nvmctrl-u2409"

include: flash-controller.yaml

properties:
  lock-regions:
    type: int
    required: true
    description: |
      Number of lock regions.
      The main address space is divided into 32 equal size regions. The region size is
      dependent on the flash memory size.Each region can be protected against write or
      erase operation.
```

## dts/bindings/flash_controller/microchip,same54-nvmctrl.yaml
```yaml
# Copyright (c) [2025] [Microchip Technology Inc.]
# SPDX-License-Identifier: Apache-2.0

description: Microchip SAME54 NVMC (Non-Volatile Memory Controller)

compatible: "microchip,same54-nvmctrl"

include: flash-controller.yaml

properties:
  lock-regions:
    type: int
    required: true
    description: Number of lock regions
```

## dts/bindings/gpio/microchip,port-g1-gpio.yaml
```yaml
# Copyright (c) 2025 Microchip Technology Inc.
# SPDX-License-Identifier: Apache-2.0

description: |
  Microchip port-g1 gpio driver bindings.

  Group g1 PORT GPIO driver supports following hardware peripherals:
    - module name="PORT" id="U2210" version="2.2.0"

compatible: "microchip,port-g1-gpio"

include: [gpio-controller.yaml, base.yaml]

properties:
  reg:
    required: true

  "#gpio-cells":
    const: 2

  "#microchip,pin-cells":
    type: int
    required: true
    const: 2
    description: |
      Number of items to expect in a microchip,pins specifier

gpio-cells:
  - pin
  - flags

microchip,pin-cells:
  - pin
  - peripheral
```
