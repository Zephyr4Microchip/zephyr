## soc/microchip/pic32c/pic32ck_gc/Kconfig.defconfig
```kconfig
# Copyright (c) 2026 Microchip Technology Inc.
# SPDX-License-Identifier: Apache-2.0

if SOC_FAMILY_MICROCHIP_PIC32CK_GC

config NUM_IRQS
	default 158

config SYS_CLOCK_HW_CYCLES_PER_SEC
	default $(dt_node_int_prop_int,/cpus/cpu@0,clock-frequency)

config ROMSTART_RELOCATION_ROM
	bool
	default y

config ROMSTART_REGION_ADDRESS
	hex
	default $(dt_nodelabel_reg_addr_hex,boot_partition)

config ROMSTART_REGION_SIZE
	hex
	default $(dt_nodelabel_reg_size_hex,boot_partition,0,k)

endif # SOC_FAMILY_MICROCHIP_PIC32CK_GC
```

## soc/microchip/pic32c/pic32ck_gc/Kconfig.soc
```kconfig
# Copyright (c) 2026 Microchip Technology Inc.
# SPDX-License-Identifier: Apache-2.0

config SOC_FAMILY_MICROCHIP_PIC32CK_GC
	bool

config SOC_FAMILY
	default "microchip_pic32ck_gc" if SOC_FAMILY_MICROCHIP_PIC32CK_GC

rsource "*/Kconfig.soc"
```

## soc/microchip/pic32c/pic32cx_bz/bz2x/Kconfig.defconfig
```kconfig
# Copyright (c) 2025 Microchip Technology Inc.
# SPDX-License-Identifier: Apache-2.0

if SOC_FAMILY_MICROCHIP_PIC32CX_BZ2

config NUM_IRQS
	default 40

config ROM_START_OFFSET
	default 0x400 if BOOTLOADER_MCUBOOT

config SYS_CLOCK_HW_CYCLES_PER_SEC
	default $(dt_node_int_prop_int,/cpus/cpu@0,clock-frequency)

config ROMSTART_RELOCATION_ROM
	default y

config ROMSTART_REGION_ADDRESS
	default 0

config BUILD_OUTPUT_HEX
	default y

config DEVICE_SUPPORT_REQUIRED
	default y if (BT || HPA_SUPPORTED || ENABLE_PMU_BUCK_MODE)

endif # SOC_FAMILY_MICROCHIP_PIC32CX_BZ2
```

## soc/microchip/pic32c/pic32cx_bz/bz2x/bz25/Kconfig.soc
```kconfig
# Copyright (c) 2025 Microchip Technology Inc.
# SPDX-License-Identifier: Apache-2.0

config SOC_SERIES_PIC32CX_BZ25
	bool
	select SOC_FAMILY_MICROCHIP_PIC32CX_BZ2
	help
	  Enable support for Microchip PIC32CX_BZ2 Cortex-M4F microcontrollers.

config SOC_SERIES
	default "bz25" if SOC_SERIES_PIC32CX_BZ25

config SOC_PIC32CX1012BZ25048
	bool
	select SOC_SERIES_PIC32CX_BZ25

config SOC
	default "pic32cx1012bz25048" if SOC_PIC32CX1012BZ25048

config HPA_SUPPORTED
	bool



rsource "Kconfig.system_config"
```

## soc/microchip/pic32c/pic32cx_bz/bz6x/bz62/Kconfig.image_header
```kconfig
# Copyright (c) 2025 Microchip Technology Inc.
# SPDX-License-Identifier: Apache-2.0


menu "Image Header Settings"
	depends on SOC_SERIES_PIC32CX_BZ62

config MD_SEQ_NUM
	hex "Metadata Sequence Number of the image"
	default 0xfffffffe

config AUTH_MTHD
	int "Metadata authentication method"
	range 0 0
	default 0
	help
		0: None

config FW_IMG_REV
	hex "Firmware Image revision"
	default 0x01000000

endmenu
```

## soc/microchip/pic32c/pic32cx_bz/bz6x/bz62/Kconfig.soc
```kconfig
# Copyright (c) 2025 Microchip Technology Inc.
# SPDX-License-Identifier: Apache-2.0

config SOC_SERIES_PIC32CX_BZ62
	bool
	select SOC_FAMILY_MICROCHIP_PIC32CX_BZ6
	help
	  Enable support for Microchip PIC32CX_BZ6 Cortex-M4F microcontrollers.

config SOC_SERIES
	default "bz62" if SOC_SERIES_PIC32CX_BZ62

config SOC_PIC32CX2051BZ62132
	bool
	select SOC_SERIES_PIC32CX_BZ62

config SOC_PIC32CX2051BZ62064
	bool
	select SOC_SERIES_PIC32CX_BZ62

config SOC
	default "pic32cx2051bz62132" if SOC_PIC32CX2051BZ62132
	default "pic32cx2051bz62064" if SOC_PIC32CX2051BZ62064


rsource "Kconfig.image_header"
rsource "Kconfig.system_config"
```

## soc/microchip/pic32c/pic32cx_bz/bz6x/bz66/Kconfig.soc
```kconfig
# Copyright (c) 2025 Microchip Technology Inc.
# SPDX-License-Identifier: Apache-2.0

config SOC_SERIES_PIC32CX_BZ66
	bool
	select SOC_FAMILY_MICROCHIP_PIC32CX_BZ6
	help
	  Enable support for Microchip PIC32CX_BZ6 Cortex-M4F microcontrollers.

config SOC_SERIES
	default "bz66" if SOC_SERIES_PIC32CX_BZ66

config SOC_PIC32CX2051BZ66048
	bool
	select SOC_SERIES_PIC32CX_BZ66

config SOC
	default "pic32cx2051bz66048" if SOC_PIC32CX2051BZ66048




rsource "Kconfig.image_header"
rsource "Kconfig.system_config"
```

## soc/microchip/sam/Kconfig
```kconfig
# Copyright (c) [2025] [Microchip Technology Inc.]
# SPDX-License-Identifier: Apache-2.0

config SOC_FAMILY_MCHP_SAM
	select HAS_CMSIS_CORE
	select HAS_SEGGER_RTT if ZEPHYR_SEGGER_MODULE
	select HAS_MCHP_HAL_DFP
	select HAS_MCHP_HAL_INCLUDE
	select HAS_MCHP_HAL_PERIPHERALS

if SOC_FAMILY_MCHP_SAM

rsource "*/Kconfig"

endif # SOC_FAMILY_MCHP_SAM
```

## soc/microchip/sam/Kconfig.soc
```kconfig
#
# Copyright (c) [2025] [Microchip Technology Inc.]
#
# SPDX-License-Identifier: Apache-2.0
#

config SOC_FAMILY_MCHP_SAM
	bool

config SOC_FAMILY
	default "microchip_sam" if SOC_FAMILY_MCHP_SAM

config SOC_SERIES_REVISION_N
	bool
	depends on SOC_FAMILY_MCHP_SAM

config SOC_SERIES_REVISION
	string
	default "n" if SOC_SERIES_REVISION_N
	default ""
	depends on SOC_FAMILY_MCHP_SAM

rsource "*/Kconfig.soc"
```

## soc/microchip/sam/sam_d5x_e5x/Kconfig
```kconfig
# Copyright (c) 2025 Microchip Technology Inc.
# SPDX-License-Identifier: Apache-2.0

config SOC_FAMILY_MCHP_SAM_D5X_E5X
	select HAS_CMSIS_CORE
	select HAS_SEGGER_RTT if ZEPHYR_SEGGER_MODULE
	select HAS_MCHP_HAL_DFP
	select HAS_MCHP_HAL_INCLUDE
	select HAS_MCHP_HAL_PERIPHERALS

if SOC_FAMILY_MCHP_SAM_D5X_E5X

rsource "*/Kconfig"

endif # SOC_FAMILY_MCHP_SAM_D5X_E5X
```

## soc/microchip/sam/sam_d5x_e5x/Kconfig.defconfig
```kconfig
# Copyright (c) 2025 Microchip Technology Inc.
# SPDX-License-Identifier: Apache-2.0

if SOC_FAMILY_MCHP_SAM_D5X_E5X

rsource "*/Kconfig.defconfig"

config SYS_CLOCK_HW_CYCLES_PER_SEC
	default $(dt_node_int_prop_int,/soc/clock@40000800/oscctrl@40001000,dfll_frequency)

endif # SOC_FAMILY_MCHP_SAM_D5X_E5X
```

## soc/microchip/sam/sam_d5x_e5x/Kconfig.soc
```kconfig
# Copyright (c) 2025 Microchip Technology Inc.
# SPDX-License-Identifier: Apache-2.0

config SOC_FAMILY_MICROCHIP_SAM_D5X_E5X
	bool

config SOC_FAMILY
	default "microchip_sam_d5x_e5x" if SOC_FAMILY_MICROCHIP_SAM_D5X_E5X

# List of Peripheral IPs available in SOC_FAMILY_MICROCHIP_SAM_D5X_E5X family
if SOC_FAMILY_MICROCHIP_SAM_D5X_E5X

config ADC_MCHP_U2500_1_0_0
	bool
	default y
	help
	  Enable ADC peripheral IP version 1.0.0 (U2500).

config PINCTRL_MCHP_PORT_U2210_2_2_0
	bool
	default y
	help
	  Enable PORT pinctrl peripheral IP version 2.2.0 (U2210).

config UART_MCHP_SERCOM_U2201_5_0_0
	bool
	default y
	help
	  Enable SERCOM UART peripheral IP version 5.0.0 (U2201).

config DMA_MCHP_DMAC_U2503_1_0_1
	bool
	default y
	help
	  Enable DMAC peripheral IP version 1.0.1 (U2503).

config WDT_MCHP_U2251_1_1_0
	bool
	default y
	help
	  The SoC contains Watchdog IP version 1.1.0 (U2251).

config RESET_MCHP_RSTC_U2239_4_0_0
	bool
	default y
	help
	  Enable RESET peripheral IP version 4.0.0 (U2239).

config FLASH_MCHP_NVMCTRL_U2409_1_0_0
	bool
	default y
	help
	  Enable FLASH peripheral IP version 1.0.0 (U2409).

config ENTROPY_MCHP_TRNG_U2242_1_1_0
	bool
	default y
	help
	  Enable ENTROPY peripheral IP version 1.1.0 (U2242).

config GPIO_MCHP_PORT_U2210_2_2_0
	bool
	default y
	help
	  Enable PORT GPIO peripheral IP version 2.2.0 (U2210).

config SPI_MCHP_SERCOM_U2201_5_0_0
	bool
	default y
	help
	  Enable SERCOM SPI peripheral IP version 5.0.0 (U2201).

config INTC_MCHP_EIC_U2254_3_0_0
	bool
	default y
	help
	  Enable EIC peripheral IP version 3.0.0 (U2254).

config RTC_MCHP_U2250_2_1_0
	bool
	default y
	help
	  Enable RTC peripheral IP version 2.1.0 (U2250).

endif # SOC_FAMILY_MICROCHIP_SAM_D5X_E5X

rsource "*/Kconfig.soc"
```

## soc/microchip/sam/same54/Kconfig
```kconfig
# Copyright (c) [2025] [Microchip Technology Inc.]
# SPDX-License-Identifier: Apache-2.0

config SOC_SERIES_MCHP_SAME54
	select ARM
	select CPU_CORTEX_M4
	select CPU_CORTEX_M_HAS_DWT
	select CPU_HAS_ARM_MPU
	select CPU_HAS_FPU
	select SOC_RESET_HOOK
	select CLOCK_CONTROL
```

## soc/microchip/sam/same54/Kconfig.defconfig
```kconfig
# Copyright (c) 2025 Microchip Technology Inc.
# SPDX-License-Identifier: Apache-2.0

if SOC_SERIES_MCHP_SAME54

config NUM_IRQS
	default 137

config ROM_START_OFFSET
	default 0x400 if BOOTLOADER_MCUBOOT

endif # SOC_SERIES_MCHP_SAME54
```

## tests/drivers/dma/chan_blen_transfer/boards/sam_e54_xpro.conf
```kconfig
# Copyright (c) 2025 Microchip Technology Inc.
# SPDX-License-Identifier: Apache-2.0

CONFIG_HEAP_MEM_POOL_SIZE=8192
```

## tests/drivers/gpio/gpio_mchp_loopback/testcase.yaml
```yaml
tests:
  drivers.gpio.gpio_mchp_loopback:
    tags:
      - drivers
      - gpio
    depends_on: gpio
    min_flash: 48
    harness: ztest
    harness_config:
      fixture: gpio_loopback
```

## tests/drivers/spi/spi_mchp_error_cases/testcase.yaml
```yaml
common:
  depends_on: spi
  tags: drivers spi
tests:
  drivers.spi.spi_mchp_error_cases:
    platform_allow:
      - sam_e54_xpro
```

## tests/drivers/spi/spi_mchp_transceive/testcase.yaml
```yaml
tests:
  drivers.spi.spi_mchp_transceive:
    tags: drivers spi
    harness: ztest
    harness_config:
      fixture: spi_loopback
```

## tests/drivers/uart/uart_mchp_elementary/testcase.yaml
```yaml
tests:
  drivers.uart.uart_mchp_elementary:
    tags: drivers uart
    depends_on: gpio
    harness: ztest
    harness_config:
      fixture: gpio_loopback
    platform_allow:
      - sam_e54_xpro
      - pic32cx_sg41_cult
      - pic32cx_sg61_cult
```
