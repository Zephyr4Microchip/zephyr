## boards/microchip/pic32c/pic32ck_gc_cult/board.yml
```yaml
# Copyright (c) 2026 Microchip Technology Inc.
# SPDX-License-Identifier: Apache-2.0

board:
  name: pic32ck_gc_cult
  full_name: PIC32CK GC Curiosity Ultra
  vendor: microchip
  socs:
    - name: pic32ck2051gc01144
```

## boards/microchip/pic32wm/pic32wm_bz6204_curiosity/board.yml
```yaml
# Copyright (c) 2025 Microchip Technology Inc.
# SPDX-License-Identifier: Apache-2.0

board:
  name: pic32wm_bz6204_curiosity
  vendor: microchip
  socs:
    - name: pic32cx2051bz62132
```

## boards/microchip/sam/sam_e54_xpro/board.yml
```yaml
#
# Copyright (c) [2025] [Microchip Technology Inc.]
#
# SPDX-License-Identifier: Apache-2.0
#

board:
  name: sam_e54_xpro
  vendor: microchip
  socs:
    - name: atsame54p20a
```

## boards/microchip/wbz/wbz450_curiosity/Kconfig.wbz450_curiosity
```kconfig
# Copyright (c) 2025 Microchip Technology Inc.
# SPDX-License-Identifier: Apache-2.0

config BOARD_WBZ450_CURIOSITY
	select SOC_PIC32CX1012BZ24032

choice FUSES_DEVCFG1_SCOM0_HSEN
	default FUSES_DEVCFG1_SCOM0_HSEN_DIRECT if $(dt_nodelabel_enabled_with_compat,sercom0,$(DT_COMPAT_MICROCHIP_SERCOM_G1_UART))
endchoice
```

## boards/microchip/wbz/wbz451_curiosity/Kconfig.wbz451_curiosity
```kconfig
# Copyright (c) 2025 Microchip Technology Inc.
# SPDX-License-Identifier: Apache-2.0

config BOARD_WBZ451_CURIOSITY
	select SOC_PIC32CX1012BZ25048

choice FUSES_DEVCFG1_SCOM0_HSEN
	default FUSES_DEVCFG1_SCOM0_HSEN_DIRECT if $(dt_nodelabel_enabled_with_compat,sercom0,$(DT_COMPAT_MICROCHIP_SERCOM_G1_UART))
endchoice

choice FUSES_DEVCFG1_SCOM1_HSEN
	default FUSES_DEVCFG1_SCOM1_HSEN_PPS if $(dt_nodelabel_enabled_with_compat,sercom1,$(DT_COMPAT_MICROCHIP_SERCOM_G1_UART))
	default FUSES_DEVCFG1_SCOM1_HSEN_DIRECT if $(dt_nodelabel_enabled_with_compat,sercom1,$(DT_COMPAT_MICROCHIP_SERCOM_G1_SPI))
endchoice

choice FUSES_DEVCFG1_SCOM2_HSEN
	default FUSES_DEVCFG1_SCOM2_HSEN_DIRECT if $(dt_nodelabel_enabled_with_compat,sercom2,$(DT_COMPAT_MICROCHIP_SERCOM_G1_I2C))
endchoice
```

## boards/microchip/wbz/wbz451_curiosity/board.yml
```yaml
# Copyright (c) 2025 Microchip Technology Inc.
# SPDX-License-Identifier: Apache-2.0

board:
  name: wbz451_curiosity
  vendor: microchip
  socs:
    - name: pic32cx1012bz25048
```

## drivers/adc/Kconfig.mchp
```kconfig
# Copyright (c) 2025 Microchip Technology Inc.
# SPDX-License-Identifier: Apache-2.0

config ADC_MCHP_G1
	bool "Microchip ADC support for G1 peripherals"
	depends on DT_HAS_MICROCHIP_ADC_G1_ENABLED
	default y
	select PINCTRL
	select ADC_CONFIGURABLE_INPUTS
	help
	  Enable support for the Microchip ADC driver on G1 ADC peripherals.

	  This driver supports Microchip device families:
	  - SOC_FAMILY_MCHP_SAM_D5X_E5X
```

## drivers/bluetooth/hci/Kconfig.mchp
```kconfig
# Copyright (c) 2025 Microchip Technology Inc.
# SPDX-License-Identifier: Apache-2.0

config BT_HCI_MCHP_BZ
	bool "Microchip Bluetooth HCI driver"
	default y
	depends on DT_HAS_MICROCHIP_PIC32CX_BZ_BT_HCI_ENABLED
	help
		This option enables the HCI driver for Microchip PIC32CX BZ BT HCI.

if BT_HCI_MCHP_BZ

config HEAP_MEM_POOL_ADD_SIZE_BT_HCI
	int
	default 32768 if SOC_FAMILY_MICROCHIP_PIC32CX_BZ6
	default 1024

endif # BT_HCI_MCHP_BZ
```

## drivers/clock_control/Kconfig.mchp_v1
```kconfig
# Copyright (c) 2025 Microchip Technology Inc.
# SPDX-License-Identifier: Apache-2.0

config CLOCK_CONTROL_MCHP_V1
	bool "Microchip MCHP_V1 CLOCK CONTROL driver"
	default y
	depends on SOC_FAMILY_MCHP_SAM_D5X_E5X
	help
	  This option enables the CLOCK CONTROL driver for Microchip SAM.
```

## drivers/comparator/Kconfig.mchp
```kconfig
#Copyright(c) 2025 Microchip Technology Inc.
#SPDX - License - Identifier : Apache - 2.0

config COMPARATOR_MCHP_AC_U2501
	bool "Microchip AC(Analog Comparator) Driver for AC_U2501 IP"
	default y
	depends on DT_HAS_MICROCHIP_AC_U2501_ENABLED
	select PINCTRL
	help
	  Enable the Microchip Analog Comparator (AC) driver.
	  This driver supports Microchip device families:
	  - SOC_FAMILY_MCHP_SAM_D5X_E5X
```

## drivers/counter/Kconfig.mchp
```kconfig
# Copyright (c) 2025 Microchip Technology Inc.
# SPDX-License-Identifier: Apache-2.0

menu "Microchip Counter Drivers"

config COUNTER_MCHP_G1_TC
	bool "Microchip TC G1 Counter driver"
	default y
	depends on DT_HAS_MICROCHIP_TC_G1_COUNTER_ENABLED
	help
	  This option enables the counter driver for Microchip timer peripherals.

config COUNTER_MCHP_G1_TCC
	bool "Microchip TCC G1 Counter driver"
	default y
	depends on DT_HAS_MICROCHIP_TCC_G1_COUNTER_ENABLED
	help
	  This option enables the counter driver for Microchip timer peripherals

config COUNTER_MCHP_G1_RTC
	bool "Microchip RTC G1 Counter driver"
	default y
	depends on DT_HAS_MICROCHIP_RTC_G1_COUNTER_ENABLED
	help
	  This option enables the counter driver for Microchip timer peripherals

endmenu
```

## drivers/dac/Kconfig.mchp
```kconfig
# Copyright (c) 2025 Microchip Technology Inc.
# SPDX-License-Identifier: Apache-2.0

config DAC_MCHP_U2502
	bool "Microchip DAC Driver for DAC U2502 Peripheral"
	default y
	depends on DT_HAS_MICROCHIP_DAC_U2502_ENABLED
	select PINCTRL
	help
	  Enable support for the Microchip MCHP V1 series Digital-to-Analog (DAC) driver.

config DAC_MCHP_DIFFERENTIAL
	bool "Differential Mode Enable"
	depends on DAC_MCHP_U2502
	help
	  Enable Differential Mode support
```

## drivers/dac/Kconfig.mchp_v1
```kconfig
# Copyright (c) 2025 Microchip Technology Inc.
# SPDX-License-Identifier: Apache-2.0

config DAC_MCHP_V1
	bool "Microchip MCHP V1 series DAC Driver"
	default y
	depends on DT_HAS_MICROCHIP_DAC_U2502_ENABLED
	select PINCTRL
	help
	  Enable support for the Microchip MCHP V1 series Digital-to-Analog (DAC) driver.

config DAC_MCHP_DIFFERENTIAL
	bool "Differential Mode Enable"
	depends on DAC_MCHP_V1
	help
	  Enable Differential Mode support for the Microchip MCHP V1 series
```

## drivers/dma/Kconfig.mchp_v1
```kconfig
#Microchip MCHP_V1 DMA driver configuration options

#Copyright(c) 2025 Microchip Technology Inc.
#SPDX - License - Identifier : Apache - 2.0

config DMA_MCHP_V1
	bool "Microchip MCHP_V1 DMA driver"
	default y
	depends on DT_HAS_MICROCHIP_DMAC_U2503_ENABLED
	depends on !DMA_64BIT
	help
	  This Option enables the DMA driver support for Microchip SAM MCUs.

if DMA_MCHP_V1

config DMA_MCHP_V1_MAX_DESC
	int "Number of DMA descriptors allocated in DMA descriptor pool"
	range 4 256
	default 128
	help
	  Defines the number of DMA descriptors in the dynamically allocated pool.
	  All DMA channels will share this common pool of descriptors.
	  Increasing this value may improve performance for systems with high
	  DMA usage but will increase memory consumption.

config DMA_MCHP_LOG_LEVEL
	int "DMA MCHP V1 driver log level"
	default 3
	range 0 4
	depends on DMA
	help
	  Sets the log level for the DMA driver.

	  Available log levels:
	  - 0: Off (No logs)
	  - 1: Error
	  - 2: Warning
	  - 3: Info (Default)
	  - 4: Debug

endif # DMA_MCHP_V1
```

## drivers/entropy/Kconfig.mchp
```kconfig
# Copyright (c) 2025 Microchip Technology Inc.
# SPDX-License-Identifier: Apache-2.0

config ENTROPY_MCHP_TRNG_U2242
    bool "Microchip MCHP U2242 Entropy Driver"
    default y
    depends on DT_HAS_MICROCHIP_TRNG_U2242_ENABLED
    select ENTROPY_HAS_DRIVER
    help
      Enable Entropy driver for Microchip MCHP U2242
```

## drivers/ethernet/Kconfig.mchp
```kconfig
# Copyright (c) 2026 Microchip Technology Inc.
# SPDX-License-Identifier: Apache-2.0

config ETH_MCHP_GMAC_G1
	bool "Microchip G1 Ethernet driver"
	default y
	depends on NET_BUF_FIXED_DATA_SIZE
	depends on DT_HAS_MICROCHIP_GMAC_G1_ETH_ENABLED
	select NOCACHE_MEMORY if ARCH_HAS_NOCACHE_MEMORY_SUPPORT
	select MDIO
	select ETH_DSA_SUPPORT_DEPRECATED
	select PINCTRL
	help
	  Enable Microchip MCU Family Ethernet driver.

# Define menu symbol for configuring ethernet features
menuconfig ETH_MCHP_GMAC
	bool "Microchip GMAC Ethernet driver"
	default y
	depends on ETH_MCHP_GMAC_G1
	help
	  Enable support for Microchip Ethernet driver.

if ETH_MCHP_GMAC

# Workaround for not being able to have commas in macro arguments
DT_ETH_MCHP_PATH := $(dt_nodelabel_path,gmac)

# Just for readability, to keep the following lines shorter.
DT_ETH_MCHP_NQ := $(dt_node_int_prop_int,$(DT_ETH_MCHP_PATH),num-queues)

config ETH_MCHP_BUF_RX_COUNT
	int "Network RX buffers preallocated by the SAM ETH driver"
	default 12
	help
	  Number of network buffers that will be permanently allocated by the
	  Ethernet driver. These buffers are used in receive path. They are
	  preallocated by the driver and made available to the GMAC module to be
	  filled in with incoming data. Their number has to be large enough to fit
	  at least one complete Ethernet frame. SAM ETH driver will always allocate
	  that amount of buffers for itself thus reducing the NET_BUF_RX_COUNT
	  which is a total amount of RX data buffers used by the whole networking
	  stack. One has to ensure that NET_PKT_RX_COUNT is large enough to
	  fit at least two Ethernet frames: one being received by the GMAC module
	  and the other being processed by the higher layer networking stack.

config ETH_MCHP_MAC_I2C_EEPROM
	default y
	select I2C
	bool "Read from an I2C EEPROM"
	help
	  Read MAC address from an I2C EEPROM.

if ETH_MCHP_MAC_I2C_EEPROM

config ETH_MCHP_MAC_I2C_INT_ADDRESS
	hex "I2C EEPROM internal address"
	default 0x9A
	range 0 0xffffffff
	help
	  Internal address of the EEPROM chip where the MAC address is stored.
	  Chips with 1 to 4 byte internal address size are supported. Address
	  size has to be configured in a separate Kconfig option.

config ETH_MCHP_MAC_I2C_INT_ADDRESS_SIZE
	int "I2C EEPROM internal address size"
	default 1
	range 1 4
	help
	  Size (in bytes) of the internal EEPROM address.

endif # ETH_MCHP_MAC_I2C_EEPROM

config ETH_MCHP_RX_THREAD_STACK_SIZE
	int "MCHP RX Work thread stack size"
	default 1600
	help
	  RX thread stack size in bytes.

config ETH_MCHP_RX_THREAD_PRIORITY
	int "MCHP RX work thread priority"
	default 2
	help
	  Ethernet Driver handles RX in thread.
	  This options sets the priority of that thread.

endif # ETH_MCHP_GMAC
```

## drivers/flash/Kconfig.mchp
```kconfig
# Copyright (c) 2025 Microchip Technology Inc.
# SPDX-License-Identifier: Apache-2.0

config FLASH_MCHP_NVMCTRL_U2409
	bool "Microchip Flash Driver for NVMCTRL_U2409 IP"
	default y
	depends on DT_HAS_MICROCHIP_NVMCTRL_U2409_ENABLED
	select FLASH_HAS_PAGE_LAYOUT
	select FLASH_HAS_EX_OP
	select FLASH_EX_OP_ENABLED
	select FLASH_HAS_DRIVER_ENABLED
	select FLASH_HAS_EXPLICIT_ERASE
	select MPU_ALLOW_FLASH_WRITE if ARM_MPU
	help
	  Enable Flash driver for Microchip Non Volatile Memory Controller.

config FLASH_HAS_UNALIGNED_WRITE
	bool "Provide unaligned write support"
	help
	  Enable this option to allow the Zephyr flash API to write data to flash
	  memory at offsets that are not aligned to the device's write block size
	  When enabled, the driver will handle unaligned writes internally, typically
	  using read-modify-write operations to ensure data integrity. This allows
	  applications to write data starting at any offset within the flash memory
	  space, not just at aligned addresses.
```

## drivers/gpio/Kconfig.mchp
```kconfig
# Copyright (c) 2025 Microchip Technology Inc.
# SPDX-License-Identifier: Apache-2.0

config GPIO_MCHP_PORT_U2210
	bool "Microchip MCHP PORT_U2210 GPIO driver"
	default y
	depends on DT_HAS_MICROCHIP_PORT_U2210_GPIO_ENABLED
	help
	  GPIO driver for Microchip MCHP PORT_U2210 (SAMD5xE5x Family).
```

## drivers/gpio/Kconfig.mchp_v1
```kconfig
# Copyright (c) 2025 Microchip Technology Inc.
# SPDX-License-Identifier: Apache-2.0

config GPIO_MCHP_V1
	bool "Microchip MCHP V1 variant GPIO driver"
	default y
	depends on DT_HAS_MICROCHIP_PORT_U2210_GPIO_ENABLED
	help
	  GPIO driver for Microchip MCHP V1 variant MCUs.
```

## drivers/i2c/Kconfig.mchp
```kconfig
# Copyright (c) 2025 Microchip Technology Inc.
# SPDX-License-Identifier: Apache-2.0

config I2C_MCHP_SERCOM
	bool
	help
	  Common options for Microchip I2C SERCOM drivers.

config I2C_MCHP_SERCOM_G1
	bool
	default y
	depends on DT_HAS_MICROCHIP_SERCOM_G1_I2C_ENABLED
	select PINCTRL
	select I2C_MCHP_SERCOM
	help
	  Enable support for Microchip SERCOM I2C g1 driver.

if I2C_MCHP_SERCOM

config I2C_MCHP_INTERRUPT_DRIVEN
	bool "Interrupt support for Microchip I2C devices"
	depends on !I2C_MCHP_DMA_DRIVEN
	help
	  This enables INTERRUPT driven transactions for the I2C peripheral.
	  interrupt driven mode can be used in blocking & non blocking mode.

config I2C_MCHP_DMA_DRIVEN
	bool "DMA support for Microchip I2C devices"
	default y
	depends on I2C_CALLBACK
	depends on DMA
	help
	  This enables DMA driven transactions for the I2C peripheral.
	  DMA driven mode requires fewer interrupts to handle the
	  transaction and ensures that high speed modes are not delayed
	  by data reloading.

config I2C_MCHP_TARGET
	bool "Target device support for Microchip I2C devices"
	default y
	depends on I2C_TARGET
	help
	  This enables target device support for the I2C peripheral.

config I2C_MCHP_TARGET_MULTI_ADDR
	bool "Multi-address target support for Microchip I2C devices"
	default n
	depends on I2C_MCHP_TARGET
	help
	  Enable dual-address target mode for Microchip I2C SERCOM devices.
	  When enabled, the driver can register two target addresses and
	  route transactions based on the matched address. Both addresses
	  must be 7-bit when using dual-address mode.

config I2C_TARGET_BUFFER_MODE
	bool "Target Buffer Mode support for Microchip I2C devices"
	default n
	depends on I2C_TARGET
	help
	  This enables buffer-based callbacks for I2C target mode.
	  This allows the driver to transfer data in chunks instead of per byte,
	  using buf_write_received() and buf_read_requested() callbacks.

config I2C_MCHP_TARGET_BUFF_SIZE
	int "Microchip I2C Target buffer size"
	default 64
	depends on I2C_TARGET_BUFFER_MODE
	range 1 256
	help
	  Size of the I2C target buffer in bytes which is used by the Microchip
	  I2C driver when operating in target (slave) mode.
	  Increase this value if you expect large read/write transfers from
	  the I2C controller. Decrease it to save memory.

config I2C_MCHP_TRANSFER_TIMEOUT
	int "Microchip Transfer timeout [ms]"
	default 500
	help
	  Timeout in milliseconds used for each I2C transfer.
	  0 means that the driver should use the K_FOREVER value,
	  i.e. it should wait as long as necessary.

endif # I2C_MCHP_SERCOM
```

## drivers/i2c/kconfig.mchp_v1
```kconfig
# Copyright (c) 2025 Microchip Technology Inc.
# SPDX-License-Identifier: Apache-2.0

menuconfig I2C_MCHP_V1
	bool "MCHP SERCOM-U2201 I2C driver"
	default y
	depends on DT_HAS_MICROCHIP_SERCOM_U2201_I2C_ENABLED
	select PINCTRL
	help
	  Enable the MCHP SERCOM-U2201 I2C driver.

config I2C_MCHP_INTERRUPT_DRIVEN
	bool "INTERRUPT support for MCHP I2C devices"
	default y
	depends on I2C_MCHP_V1
	depends on !I2C_MCHP_DMA_DRIVEN
	help
	  This enables INTERRUPT driven transactions for the I2C peripheral.
	  INTERRUPT driven mode can be used in blocking & non blocking mode.
 
config I2C_MCHP_DMA_DRIVEN
	bool "DMA support for MCHP I2C devices"
	default y
	depends on I2C_MCHP_V1 && I2C_CALLBACK
	select DMA
	help
	  This enables DMA driven transactions for the I2C peripheral.
	  DMA driven mode requires fewer interrupts to handle the
	  transaction and ensures that high speed modes are not delayed
	  by data reloading.	  	  

config I2C_MCHP_TARGET
	bool "Target device support for MCHP I2C devices"
	default y
	depends on I2C_MCHP_V1 && I2C_TARGET
	help
	  This enables target device (slave) support for the I2C peripheral.

config I2C_MCHP_TRANSFER_TIMEOUT
	int "MCHP Transfer timeout [ms]"
	default 500
	help
	  Timeout in milliseconds used for each I2C transfer.
	  0 means that the driver should use the K_FOREVER value,
	  i.e. it should wait as long as necessary.
```
