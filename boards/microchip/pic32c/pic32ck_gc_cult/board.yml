## drivers/ieee802154/Kconfig.mchp_pic32cx_bz
```kconfig
# Microchip PIC32CX_BZ configuration options

# Copyright (c) 2025 Microchip
# SPDX-License-Identifier: Apache-2.0


menuconfig IEEE802154_PIC32CX_BZ
	bool "Microchip PIC32CX_BZ Driver support"
	default y
	depends on DT_HAS_MICROCHIP_PIC32CX_BZ_IEEE802154_ENABLED
	#select MCHP_IEEE802154_PHY_DRIVER

if IEEE802154_PIC32CX_BZ

config IEEE802154_PIC32CX_BZ_RX_STACK_SIZE
	int "Driver's internal RX thread stack size"
	default 800
	help
	  This option sets the driver's stack size for its internal RX thread.
	  The default value should be sufficient, but in case it proves to be
	  a too little one, this option makes it easy to play with the size.

config IEEE802154_PIC32CX_BZ_INIT_PRIO
	int "RF2X initialization priority"
	default 80
	help
	  Set the initialization priority number. Do not mess with it unless
	  you know what you are doing. It has to start before the net stack.

config IEEE802154_PIC32CX_BZ_CRYPTO
	bool "Radio Interface layer cyptography"
	default n
	help
	  This helps encryption of Enhanced ACK frame

config IEEE802154_PIC32CX_BZ_CARRIER_FUNCTIONS
	bool "Radio Interface layer carrier functions"
	default n
	help
	  This helps enabling continuous wave carrier functions
endif
```

## drivers/interrupt_controller/Kconfig.mchp
```kconfig
# Copyright (c) 2025 Microchip Technology Inc.
# SPDX-License-Identifier: Apache-2.0

config INTC_MCHP_EIC_G1
	bool "External Interrupt Controller (EIC) Driver for Microchip devices"
	default y
	depends on DT_HAS_MICROCHIP_EIC_G1_INTC_ENABLED
	help
	  Enable EIC driver for Microchip EIC G1 peripherals. This is required for
	  GPIO interrupt support.
	  This driver supports Microchip device families:
	  - SOC_FAMILY_MCHP_SAM_D5X_E5X
```

## drivers/mspi/Kconfig.mchp
```kconfig
config MSPI_MCHP_G1
	bool "Microchip MSPI G1 QSPI driver"
	default y
	depends on DT_HAS_MICROCHIP_QSPI_G1_MSPI_ENABLED
	depends on CLOCK_CONTROL
	depends on PINCTRL
	help
	  Enable support for the Microchip MSPI Group 1 (G1) QSPI driver.
```

## drivers/pinctrl/Kconfig.mchp
```kconfig
# Copyright (c) 2025 Microchip Technology Inc.
# SPDX-License-Identifier: Apache-2.0

config PINCTRL_MCHP_PORT_G1
	bool "Microchip PORT G1 pin controller driver"
	default y
	depends on DT_HAS_MICROCHIP_PORT_G1_PINCTRL_ENABLED
	help
	  This option enables PINCTRL driver for group (g1) of PORT peripherals.


config PINCTRL_MCHP_PPS_G1
	bool "Microchip PPS G1 pin controller driver"
	default y
	depends on DT_HAS_MICROCHIP_PPS_G1_PINCTRL_ENABLED
	help
	  This option enables PINCTRL driver for group (g2) of PPS peripherals.
```
