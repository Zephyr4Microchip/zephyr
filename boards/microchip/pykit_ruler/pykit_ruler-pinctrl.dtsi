/*
 * Copyright (c) 2026 Microchip Technology Inc.
 *
 * SPDX-License-Identifier: Apache-2.0
 */

#include <dt-bindings/sam/sam_d5x_e5x/atsame51/atsame51j20a-pinctrl.h>

&pinctrl {
	sercom5_uart_default: sercom5-uart-default {
		group1 {
			pinmux = <PA22D_SERCOM5_PAD1>,
				 <PA23D_SERCOM5_PAD0>;
		};
	};
};
