## boards/microchip/pic32wm/pic32wm_bz6204_curiosity/Kconfig.pic32wm_bz6204_curiosity
```kconfig
# Copyright (c) 2025 Microchip Technology Inc.
# SPDX-License-Identifier: Apache-2.0

config BOARD_PIC32WM_BZ6204_CURIOSITY
	select SOC_PIC32CX2051BZ62132

choice FUSES_DEVCFG1_SCOM0_HSEN
	default FUSES_DEVCFG1_SCOM0_HSEN_PPS if $(dt_nodelabel_enabled_with_compat,sercom0,$(DT_COMPAT_MICROCHIP_SERCOM_G1_UART))
endchoice

choice FUSES_DEVCFG1_SCOM1_HSEN
	default FUSES_DEVCFG1_SCOM1_HSEN_DIRECT if $(dt_nodelabel_enabled_with_compat,sercom1,$(DT_COMPAT_MICROCHIP_SERCOM_G1_I2C))
endchoice

choice FUSES_DEVCFG4_VBKP_32KCSEL
	default FUSES_DEVCFG4_VBKP_32KCSEL_SOSC if LOW_POWER_CLOCK_SOURCE_SOSC
	default FUSES_DEVCFG4_VBKP_32KCSEL_POSC if LOW_POWER_CLOCK_SOURCE_POSC
endchoice

choice FUSES_DEVCFG4_LPCLK_MOD
	default FUSES_DEVCFG4_LPCLK_MOD_DIV_1_024  if LOW_POWER_CLOCK_SOURCE_SOSC
	default FUSES_DEVCFG4_LPCLK_MOD_DIV_1  if LOW_POWER_CLOCK_SOURCE_POSC
endchoice

choice FUSES_DEVCFG4_LPOSCEN
	default FUSES_DEVCFG4_LPOSCEN_ON if LOW_POWER_CLOCK_SOURCE_SOSC
	default FUSES_DEVCFG4_LPOSCEN_OFF if LOW_POWER_CLOCK_SOURCE_POSC
endchoice
```

## boards/microchip/pykit_ruler/Kconfig.defconfig
```kconfig
# Copyright (c) 2026 Microchip Technology Inc.
# SPDX-License-Identifier: Apache-2.0

if BOARD_PYKIT_RULER

config EEPROM
	default y if NVMEM

endif # BOARD_PYKIT_RULER
```

## boards/microchip/pykit_ruler/Kconfig.pykit_ruler
```kconfig
# Copyright (c) 2026 Microchip Technology Inc.
# SPDX-License-Identifier: Apache-2.0

config BOARD_PYKIT_RULER
	select SOC_ATSAME51J20A
```

## boards/microchip/pykit_ruler/board.yml
```yaml
# Copyright (c) 2026 Microchip Technology Inc.
# SPDX-License-Identifier: Apache-2.0

board:
  name: pykit_ruler
  full_name: PyKIT Ruler
  vendor: microchip
  socs:
    - name: atsame51j20a
```

## boards/microchip/sam/pykit_explorer/Kconfig.pykit_explorer
```kconfig
# SPDX-License-Identifier: Apache-2.0

config BOARD_PYKIT_EXPLORER
	select SOC_ATSAME51J20A
```

## boards/microchip/sam/pykit_explorer/board.yml
```yaml
# Copyright (c) 2024 Microchip Technology Inc.
# SPDX-License-Identifier: Apache-2.0

board:
  name: pykit_explorer
  full_name: Microchip PyKit Explorer
  vendor: microchip
  socs:
    - name: atsame51j20a
```

## boards/microchip/wbz/wbz351_curiosity/board.yml
```yaml
# Copyright (c) 2025 Microchip Technology Inc.
# SPDX-License-Identifier: Apache-2.0

board:
  name: wbz351_curiosity
  vendor: microchip
  socs:
    - name: pic32cx5109bz31048
```

## boards/microchip/wbz/wbz450_curiosity/Kconfig.defconfig
```kconfig
# Copyright (c) 2025 Microchip Technology Inc.
# SPDX-License-Identifier: Apache-2.0

if IEEE802154

config FPU
	default y

config MAIN_STACK_SIZE
	default 4096

endif # IEEE802154
```

## boards/microchip/wbz/wbz451hpe_curiosity/Kconfig.defconfig
```kconfig
# Copyright (c) 2025 Microchip Technology Inc.
# SPDX-License-Identifier: Apache-2.0

config HPA_SUPPORTED
	default y if (BT || IEEE802154)
```

## drivers/can/Kconfig.mchp
```kconfig
# Microchip unified M_CAN CAN driver configuration
# Copyright (c) 2026 Microchip Technology Inc.
# SPDX-License-Identifier: Apache-2.0

config CAN_MCHP_MCAN_G1
	bool "Microchip M_CAN G1 unified CAN driver"
	default y
	depends on DT_HAS_MICROCHIP_MCAN_G1_ENABLED
	select CAN_MCAN
	select PINCTRL
	select CLOCK_CONTROL_MCHP_GET_RATE
	help
	  Enable the unified CAN driver for Microchip MCUs using the
	  Bosch M_CAN IP core (ISO 11898-1:2015, CAN 2.0 A/B, CAN FD).

	  Supported families:
	    - PIC32CK SG/GC series (two clocks: mclk + gclk)
	    - PIC32CX BZ6 series   (one clock: gclk only;
	                            PMD3 module enable + CFG_CFGCON1 pin route)
```

## drivers/clock_control/Kconfig.mchp
```kconfig
# Copyright (c) 2025 Microchip Technology Inc.
# SPDX-License-Identifier: Apache-2.0

config CLOCK_CONTROL_MCHP_COMMON
	bool  "Microchip clock controller"
	help
	  Common options for Microchip clock control drivers.

config CLOCK_CONTROL_MCHP_SAM_D5X_E5X
	bool
	default y
	depends on DT_HAS_MICROCHIP_SAM_D5X_E5X_CLOCK_ENABLED
	help
	  This symbol define clock driver for Microchip SAM_D5X_E5X family.

config CLOCK_CONTROL_MCHP_PIC32CX_BZ2
	bool
	default y
	depends on DT_HAS_MICROCHIP_PIC32CX_BZ2_CLOCK_ENABLED
	select CLOCK_CONTROL_MCHP_COMMON
	help
	  Enable clock controller driver for Microchip PIC32CX_BZ2 family.

# Symbol for enabling clock driver for a family
config CLOCK_CONTROL_MCHP_PIC32CX_BZ3
	bool
	default y
	depends on DT_HAS_MICROCHIP_PIC32CX_BZ3_CLOCK_ENABLED
	select CLOCK_CONTROL_MCHP_COMMON
	help
	  Enable clock controller driver for Microchip PIC32CX_BZ3 family.

# Symbol for enabling clock driver for a family
config CLOCK_CONTROL_MCHP_PIC32CX_BZ6
	bool
	default y
	depends on DT_HAS_MICROCHIP_PIC32CX_BZ6_CLOCK_ENABLED
	select CLOCK_CONTROL_MCHP_COMMON
	help
	  Enable clock controller driver for Microchip PIC32CX_BZ6 family.

if CLOCK_CONTROL_MCHP_COMMON

config CLOCK_CONTROL_MCHP_CONFIG_BOOTUP
	bool "Bootup clock configuration"
	default y
	help
	  This option enables bootup clock configuration from device tree node.

config CLOCK_CONTROL_MCHP_CONFIG_RUNTIME
	bool "Runtime clock configuration"
	default y
	help
	  This option enables runtime clock configuration using API.

config CLOCK_CONTROL_MCHP_ASYNC_ON
	bool "Async clock on"
	default n
	help
	  This option enables async on API.

config CLOCK_CONTROL_MCHP_GET_RATE
	bool "Get clock rate"
	default y
	help
	  Enable support for retrieving the clock rate. This may increase
	  code size, depending on the depth of clock source hierarchy.

config CLOCK_CONTROL_MCHP_SET_RATE
	bool "Set clock rate"
	default n
	depends on CLOCK_CONTROL_MCHP_GET_RATE
	help
	  This option enables set rate API. This may increase
	  code size, depending on the depth of clock source hierarchy.

endif # CLOCK_CONTROL_MCHP_COMMON
```

## drivers/crypto/Kconfig.mchp_g2
```kconfig
# Copyright (c) 2022 Intel Corporation
# SPDX-License-Identifier: Apache-2.0


config CRYPTO_MCHP_G2
	bool "Microchip AES Engine driver for Group 2 devices"
	default y
	depends on DT_HAS_MICROCHIP_CRYPTO_G2_ENABLED
	help
	  Enable Microchip G2 crypto (AES) driver.
	  Symmetric crypto provides a single hardware interface
	  to AES.

config CRYPTO_MCHP_G2_INIT_PRIORITY
	int "Crypto device initialization priority"
	default 50
	help
	  Set the initialization priority number. Do not mess with it unless
	  you know what you are doing. It has to start before the net stack.
```

## drivers/watchdog/Kconfig.mchp
```kconfig
# Copyright (c) 2025 Microchip Technology Inc.
# SPDX-License-Identifier: Apache-2.0

config WDT_MCHP_G1
	bool "Microchip G1 Watchdog (WDT) Driver"
	default y
	depends on DT_HAS_MICROCHIP_WDT_G1_ENABLED
	select HAS_WDT_DISABLE_AT_BOOT
	help
	  Enable WDT driver for Microchip G1 IPs.

config WDT_MCHP_G2
	bool "Microchip G2 Watchdog (WDT) Driver"
	default y
	depends on DT_HAS_MICROCHIP_WDT_G2_ENABLED
	select HAS_WDT_DISABLE_AT_BOOT
	select HAS_WDT_NO_CALLBACKS
	help
	  Enable WDT driver for Microchip G2 IPs.
```

## dts/bindings/adc/microchip,adc-g2.yaml
```yaml
# Copyright (c) 2025 Microchip Technology Inc.
# SPDX-License-Identifier: Apache-2.0

description: |
  Binding for the Microchip ADC driver supporting Group G2 peripherals.

  Group G2 ADC driver supports the following hardware peripheral:
    - module name="ADC" id="02508" version="1.0.0"

compatible: "microchip,adc-g2"

include:
  - name: adc-controller.yaml
  - name: pinctrl-device.yaml

properties:
  reg:
    required: true
    description: |
      Register base address and size for the ADC peripheral.

  interrupts:
    required: true
    description: |
      Interrupt specifier for the ADC peripheral.

  adcsel:
    type: string
    required: true
    enum:
      - "pbclk"
      - "frc"
      - "refclk3"
      - "sysclk"
    default: "pbclk"
    description: Analog-to-Digital Clock Source (TCLK)

  vref-mv:
    type: int
    description: |
      ADC reference voltage in millivolts.

      This should match the reference selected in hardware or software config.

  conclkdiv:
    type: int
    required: true
    description: |
      Analog-to-Digital Control Clock (TQ) Divider value. Must be between 1 and 64 inclusive.

      The ADC clock is derived by dividing the source clock by this conclkdiv.

  adcdiv:
    type: int
    required: true
    description: |
      Division Ratio for the Shared SAR ADC Core Clock. Must be a multiples of 2 between 2 and 254
      inclusive.

      The shared SAR ADC core clock is derived by dividing the ADC clock by this adcdiv.

  num-channels:
    type: int
    required: true
    default: 8
    description: |
      Number of input channels supported by this ADC instance.

  "#io-channel-cells":
    const: 1
    description: |
      Specifies that each io-channel uses a single cell (input index).

  fract:
    type: string
    required: true
    enum:
      - "integer"
      - "fractional"
    description: |
      Fractional Data Output Format.

  sign:
    type: boolean
    description: |
      Using signed Data Output mode.

io-channel-cells:
  - input
```

## dts/bindings/crypto/microchip,crypto-g2.yaml
```yaml
# Copyright (c) 2025 Microchip Technology Inc.
# SPDX-License-Identifier: Apache-2.0

description: |
  Microchip G2 AES crypto driver binding.

  This binding represents the Crypto Accelerator Module (CAM) hardware
  present on PIC32CX-BZ6 family devices.  The peripheral
  is managed entirely by the pre-built libcam05354-pic32wm.a library; no
  memory-mapped register access is performed directly by the Zephyr driver.

compatible: "microchip,crypto-g2"

include: base.yaml
```

## dts/bindings/interrupt-controller/microchip,eic-g2-intc.yaml
```yaml
# Copyright (c) 2025 Microchip Technology Inc.
# SPDX-License-Identifier: Apache-2.0

description: |
  Microchip External Interrupt Controller for g2 peripherals

  Group g2 EIC driver supports following hardware peripherals:
    - module name="EIC" id="U2254" version="3.0.0"

compatible: "microchip,eic-g2-intc"

include:
  - name: base.yaml
  - name: pinctrl-device.yaml

properties:
  reg:
    required: true
    description: |
      Specifies the base address and size of the register

  interrupts:
    required: true
    description: |
      Specifies the interrupt line in the NVIC

  low-power-mode:
    type: boolean
    description: |
      Enables low power mode for eic peripheral
```

## dts/bindings/rng/microchip,trng-g2-entropy.yaml
```yaml
# Copyright (c) 2026, Microchip Technologies Inc.
# SPDX-License-Identifier: Apache-2.0

description: |
  Microchip TRNG driver bindings.

  Group g2 TRNG driver supports CAM lite hardware peripheral

compatible: "microchip,trng-g2-entropy"

include: base.yaml

properties:
  reg:
    required: true

  interrupts:
    required: true
```

## samples/bluetooth/hci_uart/boards/wbz351_curiosity.conf
```kconfig
#
# Copyright (c) 2025 Microchip Technology Inc.
#
# SPDX-License-Identifier: Apache-2.0
#

CONFIG_BT_BUF_ACL_TX_SIZE=255
CONFIG_BT_BUF_ACL_TX_COUNT=10
CONFIG_BT_MAX_CONN=8
```

## soc/microchip/pic32c/pic32cx_bz/Kconfig.soc
```kconfig
# Copyright (c) 2025 Microchip Technology Inc.
# SPDX-License-Identifier: Apache-2.0

config ENABLE_PMU_BUCK_MODE
	bool "PMU Buck Mode support" if !SOC_SERIES_PIC32CX_BZ3

config CUSTOM_ANTENNA_GAIN
	int "Custom Antenna Gain (dBm)"
	default 5 if SOC_SERIES_PIC32CX_BZ24
	default 4 if HPA_SUPPORTED && SOC_SERIES_PIC32CX_BZ25
	default 3
	range -5 6

choice LOW_POWER_CLOCK_SOURCE
	prompt "Low Power/RTC Clock Source"
	default LOW_POWER_CLOCK_SOURCE_SOSC
	help
	  Selection of the clock source in low power mode
	  - LOW_POWER_CLOCK_SOURCE_POSC: better clock accuracy
	  - LOW_POWER_CLOCK_SOURCE_SOSC: better current consumption, save around 200 uA

	config LOW_POWER_CLOCK_SOURCE_POSC
		bool "POSC"
	config LOW_POWER_CLOCK_SOURCE_SOSC
		bool "SOSC"
endchoice

rsource "*/Kconfig.soc"
rsource "Kconfig.image_header"
rsource "Kconfig.system_config"
```

## soc/microchip/pic32c/pic32cx_bz/bz3x/Kconfig.soc
```kconfig
# Copyright (c) 2025 Microchip Technology Inc.
# SPDX-License-Identifier: Apache-2.0

config SOC_FAMILY_MICROCHIP_PIC32CX_BZ3
	bool

config SOC_FAMILY
	default "microchip_pic32cx_bz3" if SOC_FAMILY_MICROCHIP_PIC32CX_BZ3

config SOC_SERIES_REVISION_N
	bool
	depends on SOC_FAMILY_MICROCHIP_PIC32CX_BZ3

config SOC_SERIES_REVISION
	string
	default "n" if SOC_SERIES_REVISION_N
	default ""
	depends on SOC_FAMILY_MICROCHIP_PIC32CX_BZ3

rsource "*/Kconfig.soc"
```

## soc/microchip/pic32c/pic32cx_bz/bz3x/bz3/Kconfig.soc
```kconfig
# Copyright (c) 2025 Microchip Technology Inc.
# SPDX-License-Identifier: Apache-2.0

config SOC_SERIES_PIC32CX_BZ3
	bool
	select SOC_FAMILY_MICROCHIP_PIC32CX_BZ3
	help
	  Enable support for Microchip PIC32CX_BZ3 Cortex-M4F microcontrollers.

config SOC_SERIES
	default "bz3" if SOC_SERIES_PIC32CX_BZ3

config SOC_PIC32CX5109BZ31048
	bool
	select SOC_SERIES_PIC32CX_BZ3

config SOC_PIC32CX5109BZ31032
	bool
	select SOC_SERIES_PIC32CX_BZ3

config SOC
	default "pic32cx5109bz31048" if SOC_PIC32CX5109BZ31048
	default "pic32cx5109bz31032" if SOC_PIC32CX5109BZ31032
```

## soc/microchip/pic32c/pic32cx_bz/bz3x/bz36/Kconfig.soc
```kconfig
# Copyright (c) 2025 Microchip Technology Inc.
# SPDX-License-Identifier: Apache-2.0

config SOC_SERIES_PIC32CX_BZ36
	bool
	select SOC_FAMILY_MICROCHIP_PIC32CX_BZ3
	help
	  Enable support for Microchip PIC32CX_BZ3 Cortex-M4F microcontrollers.

config SOC_SERIES
	default "bz36" if SOC_SERIES_PIC32CX_BZ36

config SOC_PIC32CX5109BZ36048
	bool
	select SOC_SERIES_PIC32CX_BZ36

config SOC_PIC32CX5109BZ36032
	bool
	select SOC_SERIES_PIC32CX_BZ36

config SOC
	default "pic32cx5109bz36048" if SOC_PIC32CX5109BZ36048
	default "pic32cx5109bz36032" if SOC_PIC32CX5109BZ36032
```
